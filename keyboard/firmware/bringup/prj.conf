## CMakeLists.txt
```
# bringup: the rev A testbed motherboard's bring-up firmware (SPEC §10), for the board kbd_testbed_a.
#   west build -b kbd_testbed_a keyboard/firmware/bringup            (the board root is set below)
# SPDX-License-Identifier: Apache-2.0

cmake_minimum_required(VERSION 3.20.0)

# The out-of-tree board kbd_testbed_a lives in keyboard/firmware/boards/: no -DBOARD_ROOT needed (one still works).
list(APPEND BOARD_ROOT ${CMAKE_CURRENT_LIST_DIR}/..)

# The simulated board (sim/): native_sim with the generated overlay of kbd_testbed_a's nodes on emulated
# controllers, and the board's bindings (prettycool,*) on the devicetree search path.
if(BOARD MATCHES "^native_sim")
  set(TB_BOARD_DIR ${CMAKE_CURRENT_LIST_DIR}/../boards/prettycool/kbd_testbed_a)
  list(APPEND DTS_ROOT ${TB_BOARD_DIR})
  list(APPEND DTC_OVERLAY_FILE ${TB_BOARD_DIR}/sim/kbd_testbed_a_sim.overlay)
  list(APPEND EXTRA_CONF_FILE ${CMAKE_CURRENT_LIST_DIR}/sim/sim.conf)
else()
  list(APPEND EXTRA_CONF_FILE ${CMAKE_CURRENT_LIST_DIR}/usb.conf)
endif()

find_package(Zephyr REQUIRED HINTS $ENV{ZEPHYR_BASE})
project(tb_bringup)

include(${CMAKE_CURRENT_SOURCE_DIR}/../lib/tb_lib.cmake)

target_sources(app PRIVATE
  ${TB_LIB_SOURCES}
  src/main.c
  src/board.c
  src/monitors.c
  src/typec.c
  src/service.c
  src/events.c
  src/out.c
  src/lanes.c
  src/descio.c
  src/slot.c
  src/coupon_test.c
  src/cmds.c
)
if(CONFIG_BRINGUP_USB)
  target_sources(app PRIVATE src/usb.c src/cdc_shell.c)
endif()
if(CONFIG_BRINGUP_SIM)
  target_sources(app PRIVATE
    sim/world.c
    sim/sim_cmds.c
    sim/emul_tca9535.c
    sim/emul_ina226.c
    sim/emul_tca9548a.c
    sim/emul_tusb320.c
    sim/emul_eeprom.c
    sim/emul_sim165.c
  )
  target_include_directories(app PRIVATE sim)
endif()
target_include_directories(app PRIVATE ${TB_LIB_INCLUDE} ${TB_BOARD_MAP_INCLUDE} src)

# Stricter than Zephyr's defaults, for this app's own sources (and the lib) only. -Wno-type-limits: with
# -Wextra, Zephyr v4.5.0's usbd_msg.h warns in every file that includes usbd.h (as in hid8k).
target_compile_options(app PRIVATE -Wextra -Wshadow -Wno-type-limits)
```

## Kconfig
```
# bringup: options. SPDX-License-Identifier: Apache-2.0

menu "Testbed bring-up"

config BRINGUP_BENCH_SUPPLY
	bool "Bench-supply mode (tb budget bench)"
	help
	  Lets the operator declare a current-limited bench supply on J1 with no USB host (SPEC §10 step 5),
	  which replaces "configured" and U_CC's reading in the VSYS budget, capped at its 2.8 A ceiling.
	  SPEC §3.5 has no such mode (the report recommends adding one). Off by default: the default build
	  follows SPEC strictly and powers no slot until a host has configured the device.

config BRINGUP_USB_VID
	hex "USB vendor ID"
	default 0x1209
	help
	  0x1209:0x0001 is the pid.codes test PID: for private testing only, not unique, never for a device
	  that is sold or shipped (as in hid8k). Bench use only.

config BRINGUP_USB_PID
	hex "USB product ID"
	default 0x0001

config BRINGUP_MON_PERIOD_MS
	int "Board service poll period (ms)"
	default 100
	range 10 2000
	help
	  How often the board service reads U_EXP2 and the monitors of the enabled rails, besides waking on
	  EXP_INT_N. The PCA95XX driver warns it cannot see short pulses, so the poll is the backstop (SPEC §8.4).

config BRINGUP_SETTLE_MS
	int "Rail settling time before checks (ms)"
	default 20
	help
	  After an enable: the TPS2553's turn-on time is 3 ms max and its FAULT deglitch 5-10 ms (SLVS841E);
	  20 ms covers both with margin. Faults on a rail younger than this are not attributed to sagging.

config BRINGUP_EVENT_RING
	int "Event ring entries"
	default 64

config BRINGUP_USB
	bool "USB device with the CDC ACM shell"
	default y
	help
	  Off in the simulated build (native_sim), where the sim commands inject the USB events instead.

config BRINGUP_SIM
	bool "Simulated board: register models of the parts (native_sim)"
	depends on ARCH_POSIX
	select EMUL
	help
	  Runs this firmware against models of the TCA9535s, the INA226s, the TCA9548A, U_CC, the descriptor
	  EEPROMs and the test coupon (sim/), on native_sim's emulated I2C, SPI, ADC and GPIO controllers, with
	  the devicetree that gen_board.py generates from the same nets.py. It tests the firmware's logic and
	  its protocol, not the hardware.

endmenu

source "Kconfig.zephyr"
```

## sample.yaml
```
# twister: build the bring-up for the board (default and bench-supply builds) and for the simulated board.
#   python3 $ZEPHYR_BASE/scripts/twister -T keyboard/firmware/bringup -A keyboard/firmware/boards -p kbd_testbed_a \
#     -p native_sim/native/64 -O <out> --disable-warnings-as-errors   (Ubuntu GCC: Zephyr's bit_rev.h warns)
# Build only: the board does not exist, and the simulated board is driven by host/test_sim.py.
sample:
  name: PrettyCool testbed bring-up
tests:
  prettycool.bringup.board:
    build_only: true
    tags: prettycool
    platform_allow:
      - kbd_testbed_a
  prettycool.bringup.board_bench:
    build_only: true
    tags: prettycool
    platform_allow:
      - kbd_testbed_a
    extra_configs:
      - CONFIG_BRINGUP_BENCH_SUPPLY=y
  prettycool.bringup.sim:
    build_only: true
    tags: prettycool
    platform_allow:
      - native_sim/native/64
```

## prj.conf
```kconfig
# bringup (Zephyr v4.5.0) for kbd_testbed_a. The board does not exist yet: compiled, never run.

# The board's buses and parts
CONFIG_GPIO=y
CONFIG_I2C=y
# Clock a stuck bus free at boot (main.c bus_check(); a warm reset mid-read can leave SDA held low, SPEC §5.2)
CONFIG_I2C_BUS_RECOVERY=y
CONFIG_SPI=y
CONFIG_ADC=y
CONFIG_SENSOR=y
CONFIG_HWINFO=y
CONFIG_REBOOT=y

# Shell on USART1 (the board's zephyr,shell-uart) and a second one on CDC ACM (src/cdc_shell.c)
CONFIG_SHELL=y
CONFIG_SHELL_BACKEND_SERIAL=y
CONFIG_SHELL_STACK_SIZE=4096
CONFIG_SHELL_CMD_BUFF_SIZE=160
CONFIG_SHELL_ARGC_MAX=12
CONFIG_SHELL_PROMPT_UART="tb:uart> "
# Raw I2C access for the engineer at the bench (scan, read); it bypasses every rule of SPEC §8.4.
CONFIG_I2C_SHELL=y

CONFIG_SERIAL=y
CONFIG_UART_INTERRUPT_DRIVEN=y

# Logs to the shells (and the console)
CONFIG_LOG=y

CONFIG_MAIN_STACK_SIZE=4096
CONFIG_SYSTEM_WORKQUEUE_STACK_SIZE=2048
CONFIG_CBPRINTF_FP_SUPPORT=n
```

## usb.conf
```kconfig
# bringup on the real board: the USB device (device_next) with CDC ACM for the second shell.
# (The simulated board, sim/sim.conf, has no USB: its "sim usb" command injects the events.)
CONFIG_USB_DEVICE_STACK_NEXT=y
CONFIG_CDC_ACM_SERIAL_INITIALIZE_AT_BOOT=n
CONFIG_UART_LINE_CTRL=y
CONFIG_USBD_LOG_LEVEL_WRN=y
CONFIG_UDC_DRIVER_LOG_LEVEL_WRN=y
CONFIG_USBD_CDC_ACM_LOG_LEVEL_WRN=y
```

## boards/kbd_testbed_a.overlay
```dts
/*
 * bringup on kbd_testbed_a: the CDC ACM function for the second shell (src/cdc_shell.c).
 *
 * SPDX-License-Identifier: Apache-2.0
 */

&zephyr_udc0 {
	cdc_acm_uart0: cdc_acm_uart0 {
		compatible = "zephyr,cdc-acm-uart";
		label = "testbed bring-up shell";
	};
};
```

## dts/bindings/prettycool,sim-165.yaml
```yaml
# SPDX-License-Identifier: Apache-2.0
description: Simulated board only (sim/emul_sim165.c) - the test coupon's SN74LV165A loopback on SPI2.
compatible: "prettycool,sim-165"
include: spi-device.yaml
```

## dts/bindings/prettycool,sim-eeprom.yaml
```yaml
# SPDX-License-Identifier: Apache-2.0
description: Simulated board only (sim/emul_eeprom.c) - every coupon's descriptor EEPROM behind the slot mux.
compatible: "prettycool,sim-eeprom"
include: i2c-device.yaml
```

## src/main.c
```c
/*
 * bringup: the rev A testbed motherboard's bring-up firmware (SPEC §10 steps 5-7) for kbd_testbed_a.
 *
 * THE BOARD DOES NOT EXIST YET. This compiles; it has never run on hardware.
 *
 * Boot order:
 *  1. POST_KERNEL, priority 51 (after I2C1/I2C4 at 50, before the TCA9535 driver at 52; the board's
 *     Kconfig.defconfig sets the gap): snapshot every expander's input, output and configuration registers and
 *     the mux's control register, before any driver touches them, so the boot report can show what an NRST left
 *     behind (SPEC §3.5, §10 step 5). Then put the hardware in SPEC §3.5's order: the mux deselected first, then,
 *     after a warm reset that left U_EXP1 driving, its bus switches open and its 5 V enables off before its
 *     3.3 V enables. (The TCA9535 driver's init then makes every pin an input, which the pull resistors turn
 *     into the same safe state.) If a bus does not answer, it is clocked free first (bus_check(): a warm reset
 *     mid-read can leave a target holding SDA low).
 *  2. main(): the board service's restore (tb_restore: every output to its safe level, the mux pulsed through
 *     RESET and deselected, all read back), the 13 monitors, the lanes, USB (CDC ACM), the second shell, the
 *     board service thread. U_CC is read by the service once it answers (up to 200 ms, SPEC §8.4).
 *
 * SPDX-License-Identifier: Apache-2.0
 */
#include <stdio.h>
#include <string.h>

#include <zephyr/drivers/hwinfo.h>
#include <zephyr/drivers/i2c.h>
#include <zephyr/init.h>
#include <zephyr/kernel.h>
#include <zephyr/logging/log.h>
#include <zephyr/sys/printk.h>
#include <zephyr/version.h>

#include "board.h"
#include "cdc_shell.h"
#include "events.h"
#include "lanes.h"
#include "monitors.h"
#include "service.h"
#include "usb.h"

LOG_MODULE_REGISTER(tb_main, LOG_LEVEL_INF);

#define SNAPSHOT_PRIO 51
BUILD_ASSERT(CONFIG_I2C_INIT_PRIORITY < SNAPSHOT_PRIO, "the snapshot needs I2C1 and I2C4 up");
BUILD_ASSERT(CONFIG_GPIO_PCA95XX_INIT_PRIORITY > SNAPSHOT_PRIO,
	     "the snapshot must run before the TCA9535 driver resets every pin to an input (board Kconfig.defconfig)");
BUILD_ASSERT(CONFIG_I2C_TCA954X_ROOT_INIT_PRIO >= CONFIG_GPIO_PCA95XX_INIT_PRIORITY,
	     "the mux's reset-gpios is on U_EXP2");

struct tb_mon_boot {
	int err;
	uint16_t mfr, die;
};
static struct tb_mon_boot mon_boot[TB_INA226_COUNT];
static int board_err, lanes_err;

static int raw_read16(const struct device *bus, uint8_t addr, uint8_t reg, uint16_t *v)
{
	uint8_t b[2];
	int err = i2c_write_read(bus, addr, &reg, 1, b, 2);

	*v = (uint16_t)(b[0] | ((uint16_t)b[1] << 8));
	return err;
}

static int raw_write8(const struct device *bus, uint8_t addr, uint8_t reg, uint8_t v)
{
	uint8_t b[2] = {reg, v};

	return i2c_write(bus, b, 2, addr);
}

/*
 * A warm reset (NRST, the debugger, the watchdog) in the middle of a read can leave a target driving SDA low: it
 * waits for clocks the reset MCU will never send (SPEC §5.2), and every transfer on that bus then fails, including
 * the ones that turn the rails off. If the first transfer on a bus fails, clock the bus free with Zephyr's bus
 * recovery (CONFIG_I2C_BUS_RECOVERY; the board's scl-gpios/sda-gpios are open drain for it) and try once more.
 * Returns 0 if the bus answered at once, 1 if it answered after a recovery, or the error.
 */
static int bus_check(const struct device *bus, uint8_t addr, uint8_t reg, uint16_t *v)
{
	uint8_t b[2];
	int err = i2c_write_read(bus, addr, &reg, 1, b, 2);

	if (err == 0) {
		*v = (uint16_t)(b[0] | ((uint16_t)b[1] << 8));
		return 0;
	}
	if (!IS_ENABLED(CONFIG_I2C_BUS_RECOVERY) || i2c_recover_bus(bus) != 0) {
		return err;
	}
	err = i2c_write_read(bus, addr, &reg, 1, b, 2);
	if (err == 0) {
		*v = (uint16_t)(b[0] | ((uint16_t)b[1] << 8));
		return 1;
	}
	return err;
}

static int tb_early_snapshot(void)
{
	const struct device *i2c1 = DEVICE_DT_GET(DT_NODELABEL(i2c1));
	const struct device *i2c4 = DEVICE_DT_GET(DT_NODELABEL(i2c4));
	static const uint8_t addrs[TB_EXP_COUNT] = TB_EXP_ADDRS;
	uint32_t cause = 0;
	uint16_t dummy;

	if (IS_ENABLED(CONFIG_HWINFO) && hwinfo_get_reset_cause(&cause) == 0) {
		(void)hwinfo_clear_reset_cause();
	}
	tb_boot.reset_cause = cause;
	if (!device_is_ready(i2c1) || !device_is_ready(i2c4)) {
		return 0;
	}
	/* U_EXP1 first on I2C1 (it holds the rail enables); the mux, I2C4's only device, answers one byte */
	tb_boot.recover_i2c1 = bus_check(i2c1, addrs[TB_EXP_EXP1_INDEX], 0x06, &dummy);
	{
		uint8_t c;
		int e = i2c_read(i2c4, &c, 1, TB_I2C_ADDR_MUX);

		if (e != 0 && IS_ENABLED(CONFIG_I2C_BUS_RECOVERY) && i2c_recover_bus(i2c4) == 0) {
			e = i2c_read(i2c4, &c, 1, TB_I2C_ADDR_MUX);
			tb_boot.recover_i2c4 = e == 0 ? 1 : e;
		} else {
			tb_boot.recover_i2c4 = e;
		}
	}
	for (int i = 0; i < TB_EXP_COUNT; i++) {
		tb_boot.err[i] = raw_read16(i2c1, addrs[i], 0x00, &tb_boot.in[i]);
		tb_boot.err[i] |= raw_read16(i2c1, addrs[i], 0x02, &tb_boot.out[i]);
		tb_boot.err[i] |= raw_read16(i2c1, addrs[i], 0x06, &tb_boot.cfg[i]);
	}
	tb_boot.mux_err = i2c_read(i2c4, &tb_boot.mux_ctrl, 1, TB_I2C_ADDR_MUX);
	/* SPEC §3.5's order after a warm reset: the mux channel off before any rail goes down... */
	{
		uint8_t zero = 0;

		(void)i2c_write(i2c4, &zero, 1, TB_I2C_ADDR_MUX);
	}
	/* ...then, if U_EXP1 still drives its pins, the bus switches open and 5 V off before 3.3 V. */
	if (tb_boot.err[TB_EXP_EXP1_INDEX] == 0 && tb_boot.cfg[TB_EXP_EXP1_INDEX] != TB_EXP_POR_CONFIG) {
		uint16_t out = tb_boot.out[TB_EXP_EXP1_INDEX];
		uint16_t busen = BIT(TB_EXPNET_BUSEN_N_S1_PIN) | BIT(TB_EXPNET_BUSEN_N_S2_PIN) |
				 BIT(TB_EXPNET_BUSEN_N_S3_PIN) | BIT(TB_EXPNET_BUSEN_N_S4_PIN) |
				 BIT(TB_EXPNET_BUSEN_N_S5_PIN);
		uint16_t en5 = BIT(TB_EXPNET_EN_5V_S1_PIN) | BIT(TB_EXPNET_EN_5V_S2_PIN) | BIT(TB_EXPNET_EN_5V_S3_PIN) |
			       BIT(TB_EXPNET_EN_5V_S4_PIN) | BIT(TB_EXPNET_EN_5V_S5_PIN) |
			       BIT(TB_EXPNET_EN_5V_KVM_PIN);
		uint16_t en3 = BIT(TB_EXPNET_EN_3V3_S1_PIN) | BIT(TB_EXPNET_EN_3V3_S2_PIN) |
			       BIT(TB_EXPNET_EN_3V3_S3_PIN) | BIT(TB_EXPNET_EN_3V3_S4_PIN) |
			       BIT(TB_EXPNET_EN_3V3_S5_PIN);
		uint16_t step1 = (uint16_t)(out | busen);
		uint16_t step2 = (uint16_t)(step1 & ~en5);
		uint16_t step3 = (uint16_t)(step2 & ~en3);
		const uint16_t steps[3] = {step1, step2, step3};

		for (int k = 0; k < 3; k++) {
			/* port 1 (P10-P17) then port 0, each a single-byte write of its output register */
			(void)raw_write8(i2c1, addrs[TB_EXP_EXP1_INDEX], 0x03, (uint8_t)(steps[k] >> 8));
			(void)raw_write8(i2c1, addrs[TB_EXP_EXP1_INDEX], 0x02, (uint8_t)steps[k]);
		}
	}
	tb_boot.valid = true;
	return 0;
}

SYS_INIT(tb_early_snapshot, POST_KERNEL, SNAPSHOT_PRIO);

static void reset_tokens(uint32_t c, char *buf, size_t n)
{
	static const struct {
		uint32_t bit;
		const char *name;
	} t[] = {
		{RESET_PIN, "pin"}, {RESET_SOFTWARE, "software"}, {RESET_BROWNOUT, "brownout"},
		{RESET_POR, "por"}, {RESET_WATCHDOG, "watchdog"}, {RESET_DEBUG, "debug"},
		{RESET_SECURITY, "security"}, {RESET_LOW_POWER_WAKE, "lowpower"}, {RESET_CPU_LOCKUP, "lockup"},
		{RESET_PARITY, "parity"}, {RESET_PLL, "pll"}, {RESET_CLOCK, "clock"}, {RESET_HARDWARE, "hardware"},
		{RESET_USER, "user"}, {RESET_TEMPERATURE, "temperature"},
	};
	size_t used = 0;

	buf[0] = '\0';
	for (size_t i = 0; i < ARRAY_SIZE(t) && used < n; i++) {
		if (c & t[i].bit) {
			used += snprintf(&buf[used], n - used, "%s%s", used ? "," : "", t[i].name);
		}
	}
	if (used == 0) {
		snprintf(buf, n, "none");
	}
}

void tb_boot_report(void (*line)(void *ctx, const char *s), void *ctx)
{
	static const uint16_t out_mask[TB_EXP_COUNT] = TB_EXP_OUTPUT_MASK;
	char b[200], cause[64];

	reset_tokens(tb_boot.reset_cause, cause, sizeof(cause));
	snprintf(b, sizeof(b),
		 "boot fw=bringup board=kbd_testbed_a map=%s nets_rev=%s zephyr=%s reset=%s snapshot=%d proto=1 "
		 "i2c1_bus=%d i2c4_bus=%d",
		 TB_MAP_HASH, TB_MAP_NETS_REV, KERNEL_VERSION_STRING, cause, tb_boot.valid, tb_boot.recover_i2c1,
		 tb_boot.recover_i2c4);
	line(ctx, b);
	for (int i = 0; i < TB_EXP_COUNT; i++) {
		bool por = tb_boot.cfg[i] == TB_EXP_POR_CONFIG;
		/* outputs an NRST left driving, and whether any of them was on */
		uint16_t driven = (uint16_t)(~tb_boot.cfg[i] & out_mask[i]);

		snprintf(b, sizeof(b),
			 "boot_exp exp=%d addr=0x%02x err=%d pre_in=0x%04x pre_out=0x%04x pre_cfg=0x%04x por=%d "
			 "driven=0x%04x post_out=0x%04x post_cfg=0x%04x ok=%d",
			 i + 1, tb_sig.exp_addr[i], tb_boot.err[i], tb_boot.in[i], tb_boot.out[i], tb_boot.cfg[i],
			 por, driven, tb.restore.out[i], tb.restore.cfg[i], tb.restore.exp_ok[i]);
		line(ctx, b);
	}
	snprintf(b, sizeof(b), "boot_mux err=%d pre=0x%02x post=0x%02x post_err=%d", tb_boot.mux_err,
		 tb_boot.mux_ctrl, tb.restore.mux_ctrl, tb.restore.mux_err);
	line(ctx, b);
	for (int i = 0; i < tb_mon_count; i++) {
		const struct tb_mon *m = tb_mon_at(i);

		snprintf(b, sizeof(b), "boot_ina addr=0x%02x rail=%s err=%d mfr=0x%04x die=0x%04x cal=%u",
			 m->bus.addr, m->name, mon_boot[i].err, mon_boot[i].mfr, mon_boot[i].die, m->cal);
		line(ctx, b);
	}
	snprintf(b, sizeof(b), "boot_restore ok=%d err=%d board_err=%d lanes_err=%d", tb.restore.ok, tb.restore.err,
		 board_err, lanes_err);
	line(ctx, b);
}

static void printk_line(void *ctx, const char *s)
{
	ARG_UNUSED(ctx);
	printk("@tb %s\n", s);
}

int main(void)
{
	int err;

	k_mutex_lock(&tb_lock, K_FOREVER);
	err = board_err = tb_board_init();
	for (int i = 0; i < tb_mon_count; i++) {
		mon_boot[i].err = tb_mon_setup(tb_mon_at(i), TB_MON_CONFIG_DEFAULT, &mon_boot[i].mfr, &mon_boot[i].die);
	}
	/* INA226 0x40's ALERT at the unconfigured budget (SPEC §8.4); the service follows the budget. */
	if (tb_mon_vsys() != NULL) {
		(void)tb_mon_set_alert(tb_mon_vsys(), tb_budget_limit_ma(&tb.budget) * 1000u);
	}
	lanes_err = tb_lanes_init();
	err |= lanes_err;
	k_mutex_unlock(&tb_lock);

	tb_boot_report(printk_line, NULL);
	if (err != 0) {
		LOG_WRN("board init incomplete (%d): see the boot lines", err);
	}

	if (IS_ENABLED(CONFIG_BRINGUP_USB)) {
		err = tb_usb_init();
		if (err != 0) {
			LOG_ERR("USB init failed (%d): the USART1 shell still works", err);
		} else if (tb_cdc_shell_start() != 0) {
			LOG_ERR("CDC ACM shell not started");
		}
	}
	tb_service_start();
	tb_ev("kind=boot restore_ok=%d", tb.restore.ok);
	return 0;
}
```

## src/board.c
```c
/*
 * The board service's hardware tables and sequences (see board.h). SPEC §3.5 and §8.4 are the rules.
 *
 * SPDX-License-Identifier: Apache-2.0
 */
#include <string.h>

#include <zephyr/devicetree.h>
#include <zephyr/drivers/gpio.h>
#include <zephyr/drivers/i2c.h>
#include <zephyr/kernel.h>
#include <zephyr/logging/log.h>
#include <zephyr/sys/util.h>
#include <zephyr/toolchain.h>

#include "board.h"
#include "events.h"
#include "monitors.h"
#include "tb/ina226.h"

LOG_MODULE_REGISTER(tb_board, LOG_LEVEL_INF);

#define TBN DT_NODELABEL(testbed)

/* TIM1 drives S5's G-lines and takes S5_IRQ_N as its break input only when an overlay enables it. */
#define TIM1_IN_USE DT_NODE_HAS_STATUS_OKAY(DT_NODELABEL(pwm1))

#define SLOT_HW(node)                                                                              \
	{                                                                                          \
		.n = DT_PROP(node, slot),                                                          \
		.lane = {ADC_DT_SPEC_GET_BY_IDX(node, 0), ADC_DT_SPEC_GET_BY_IDX(node, 1),         \
			 ADC_DT_SPEC_GET_BY_IDX(node, 2), ADC_DT_SPEC_GET_BY_IDX(node, 3)},        \
		.g = {GPIO_DT_SPEC_GET_BY_IDX(node, g_gpios, 0), GPIO_DT_SPEC_GET_BY_IDX(node, g_gpios, 1), \
		      GPIO_DT_SPEC_GET_BY_IDX(node, g_gpios, 2), GPIO_DT_SPEC_GET_BY_IDX(node, g_gpios, 3), \
		      GPIO_DT_SPEC_GET_BY_IDX(node, g_gpios, 4),                                   \
		      GPIO_DT_SPEC_GET_BY_IDX(node, g_gpios, 5)},                                  \
		.cs = {GPIO_DT_SPEC_GET_BY_IDX(node, cs_gpios, 0),                                 \
		       GPIO_DT_SPEC_GET_BY_IDX(node, cs_gpios, 1)},                                \
		.irq = GPIO_DT_SPEC_GET(node, irq_gpios),                                          \
		.irq_bkin = DT_PROP(node, irq_is_tim1_bkin),                                       \
		.present = GPIO_DT_SPEC_GET(node, present_gpios),                                  \
		.en3 = GPIO_DT_SPEC_GET(node, en_3v3_gpios),                                       \
		.en5 = GPIO_DT_SPEC_GET(node, en_5v_gpios),                                        \
		.busen = GPIO_DT_SPEC_GET(node, busen_gpios),                                      \
		.led = GPIO_DT_SPEC_GET(node, led_gpios),                                          \
		.pg5 = GPIO_DT_SPEC_GET_OR(node, pg_5v_gpios, {0}),                                \
		.i2c_ch = DEVICE_DT_GET(DT_PHANDLE(node, i2c_channel)),                            \
		.rule3_ma = DT_PROP(node, rule_3v3_milliamps),                                     \
		.rule5_ma = DT_PROP(node, rule_5v_milliamps),                                      \
		.trip3_ma = DT_PROP(node, trip_3v3_milliamps),                                     \
		.trip5_ma = DT_PROP(node, trip_5v_milliamps),                                      \
		.rail3 = DT_PROP(node, rail_3v3),                                                  \
		.rail5 = DT_PROP(node, rail_5v),                                                   \
	}

const struct tb_slot_hw tb_slots[TB_SLOTS] = {
	SLOT_HW(DT_NODELABEL(slot1)), SLOT_HW(DT_NODELABEL(slot2)), SLOT_HW(DT_NODELABEL(slot3)),
	SLOT_HW(DT_NODELABEL(slot4)), SLOT_HW(DT_NODELABEL(slot5)),
};

/* The alternate converter channels per slot: <lane adc channel> triples from the devicetree. */
#define ALT_TAB(node) DT_PROP_OR(node, alt_adc_channels, {0})
#define ALT_LEN(node) DT_PROP_LEN_OR(node, alt_adc_channels, 0)
static const uint8_t alt1[] = ALT_TAB(DT_NODELABEL(slot1));
static const uint8_t alt2[] = ALT_TAB(DT_NODELABEL(slot2));
static const uint8_t alt3[] = ALT_TAB(DT_NODELABEL(slot3));
static const uint8_t alt4[] = ALT_TAB(DT_NODELABEL(slot4));
static const uint8_t alt5[] = ALT_TAB(DT_NODELABEL(slot5));
static const uint8_t *const alt_tab[TB_SLOTS] = {alt1, alt2, alt3, alt4, alt5};
static const uint8_t alt_len[TB_SLOTS] = {
	ALT_LEN(DT_NODELABEL(slot1)), ALT_LEN(DT_NODELABEL(slot2)), ALT_LEN(DT_NODELABEL(slot3)),
	ALT_LEN(DT_NODELABEL(slot4)), ALT_LEN(DT_NODELABEL(slot5)),
};

const struct tb_signals tb_sig = {
	.exp_int = GPIO_DT_SPEC_GET(TBN, exp_int_gpios),
	.slot_fault = GPIO_DT_SPEC_GET(TBN, slot_fault_gpios),
	.pm_alert = GPIO_DT_SPEC_GET(TBN, pm_alert_gpios),
	.vsys_pg = GPIO_DT_SPEC_GET(TBN, vsys_pg_gpios),
	.s5_pg = GPIO_DT_SPEC_GET(TBN, s5_pg_gpios),
	.usbc_int = GPIO_DT_SPEC_GET(TBN, usbc_int_gpios),
	.kvm_present = GPIO_DT_SPEC_GET(TBN, kvm_present_gpios),
	.mux_rst = GPIO_DT_SPEC_GET(TBN, mux_rst_gpios),
	.kvm_rst = GPIO_DT_SPEC_GET(TBN, kvm_rst_gpios),
	.en_5v_kvm = GPIO_DT_SPEC_GET(TBN, en_5v_kvm_gpios),
	.slot_sync = GPIO_DT_SPEC_GET(TBN, slot_sync_gpios),
	.rig_mark = GPIO_DT_SPEC_GET(TBN, rig_mark_gpios),
	.rig_trig = GPIO_DT_SPEC_GET(TBN, rig_trig_gpios),
	.typec = I2C_DT_SPEC_GET(DT_PHANDLE(TBN, typec)),
	.mux = I2C_DT_SPEC_GET(DT_PHANDLE(TBN, slot_mux)),
	.exp = {DEVICE_DT_GET(DT_NODELABEL(u_exp1)), DEVICE_DT_GET(DT_NODELABEL(u_exp2)),
		DEVICE_DT_GET(DT_NODELABEL(u_exp3))},
	.exp_addr = TB_EXP_ADDRS,
	.i2c_pm = DEVICE_DT_GET(DT_NODELABEL(i2c1)),
	.ldo_ma = DT_PROP(TBN, slot_ldo_milliamps),
	.base_ma = DT_PROP(TBN, base_load_milliamps),
	.vsys_max_ma = DT_PROP(TBN, vsys_budget_max_milliamps),
	.vsys_unconf_ma = DT_PROP(TBN, vsys_budget_unconfigured_milliamps),
	.kvm_rule_ma = DT_PROP(TBN, kvm_rule_milliamps),
	.kvm_trip_ma = DT_PROP(TBN, kvm_trip_milliamps),
};

/* The devicetree and the generated map come from the same nets.py: check that they agree where both say. */
BUILD_ASSERT(DT_PROP(TBN, slot_ldo_milliamps) == TB_SLOT_LDO_MA);
BUILD_ASSERT(DT_PROP(TBN, vsys_budget_max_milliamps) == TB_VSYS_BUDGET_MAX_MA);
BUILD_ASSERT(DT_PROP(TBN, vsys_budget_unconfigured_milliamps) == TB_VSYS_BUDGET_UNCONFIGURED_MA);
BUILD_ASSERT(DT_REG_ADDR(DT_PHANDLE(TBN, typec)) == TB_I2C_ADDR_TUSB320);
BUILD_ASSERT(DT_REG_ADDR(DT_PHANDLE(TBN, slot_mux)) == TB_I2C_ADDR_MUX);
BUILD_ASSERT(DT_PROP(DT_NODELABEL(slot1), rail_3v3) == TB_RAIL_3V3_S1);
BUILD_ASSERT(DT_PROP(DT_NODELABEL(slot5), rail_5v) == TB_RAIL_5V_S5);

__weak void tb_sim_sync(void)
{
}

K_MUTEX_DEFINE(tb_lock);
struct tb_state tb;
struct tb_boot_snapshot tb_boot;

const struct tb_slot_hw *tb_slot_hw(int slot)
{
	return (slot >= 1 && slot <= TB_SLOTS) ? &tb_slots[slot - 1] : NULL;
}

bool tb_pin_level(uint16_t port, const struct gpio_dt_spec *s)
{
	return ((port >> s->pin) & 1u) != 0;
}

bool tb_pin_active(uint16_t port, const struct gpio_dt_spec *s)
{
	return tb_pin_level(port, s) != ((s->dt_flags & GPIO_ACTIVE_LOW) != 0);
}

int tb_exp_read(int exp, uint8_t reg, uint16_t *val)
{
	uint8_t buf[2];
	int err;

	if (exp < 0 || exp >= TB_EXP_COUNT) {
		return -EINVAL;
	}
	err = i2c_write_read(tb_sig.i2c_pm, tb_sig.exp_addr[exp], &reg, 1, buf, 2);
	if (err == 0) {
		*val = (uint16_t)(buf[0] | ((uint16_t)buf[1] << 8));
	}
	return err;
}

int tb_exp2_inputs(uint16_t *raw)
{
	gpio_port_value_t v = 0;
	int err = gpio_port_get_raw(tb_sig.exp[TB_EXP_EXP2_INDEX], &v);

	*raw = (uint16_t)v;
	return err;
}

int tb_mux_read(uint8_t *ctrl)
{
	return i2c_read_dt(&tb_sig.mux, ctrl, 1);
}

int tb_mux_deselect(void)
{
	/* The mux's own driver keeps a channel cache of 0 with idle-disconnect; writing 0 keeps it true. */
	uint8_t zero = 0;

	return i2c_write_dt(&tb_sig.mux, &zero, 1);
}

static int cfg(const struct gpio_dt_spec *s, gpio_flags_t f)
{
	if (s->port == NULL) {
		return 0;
	}
	if (!gpio_is_ready_dt(s)) {
		return -ENODEV;
	}
	return gpio_pin_configure_dt(s, f);
}

int tb_slot_lines(int slot, bool powered)
{
	const struct tb_slot_hw *h = tb_slot_hw(slot);
	int err = 0;

	if (h == NULL) {
		return -EINVAL;
	}
	for (int i = 0; i < 2; i++) {
		err |= cfg(&h->cs[i], powered ? GPIO_OUTPUT_INACTIVE : GPIO_DISCONNECTED);
	}
	for (int i = 0; i < 6; i++) {
		if (h->g[i].port == tb_sig.exp[TB_EXP_EXP3_INDEX]) {
			/* G4/G5 of S1-S4 on U_EXP3: driven low either way (SPEC §3.5 allows low into an unpowered
			 * slot), and the 100 k pull-downs hold them there after a reset. */
			err |= cfg(&h->g[i], GPIO_OUTPUT_INACTIVE);
		} else {
			err |= cfg(&h->g[i], powered ? GPIO_OUTPUT_INACTIVE : GPIO_DISCONNECTED);
		}
	}
	if (!(h->irq_bkin && TIM1_IN_USE)) {
		/* With TIM1 running, PE15 must stay TIM1_BKIN: never gpio_pin_configure() it (SPEC §5.3). */
		err |= cfg(&h->irq, powered ? GPIO_INPUT : GPIO_DISCONNECTED);
	}
	return err ? -EIO : 0;
}

int tb_slot_bus(int slot, bool closed)
{
	const struct tb_slot_hw *h = tb_slot_hw(slot);
	int err;

	if (h == NULL) {
		return -EINVAL;
	}
	err = gpio_pin_set_dt(&h->busen, closed ? 1 : 0);
	if (err == 0) {
		WRITE_BIT(tb.bus_closed, slot - 1, closed);
	}
	return err;
}

bool tb_rail_settling(int rail)
{
	return tb_rail_valid(rail) && (tb.budget.on & TB_RAIL_BIT(rail)) &&
	       k_uptime_get() - tb.on_since_ms[rail] < CONFIG_BRINGUP_SETTLE_MS;
}

static const struct gpio_dt_spec *en_of(int rail)
{
	int slot = tb_rail_slot(rail);

	if (rail == TB_RAIL_5V_KVM) {
		return &tb_sig.en_5v_kvm;
	}
	if (slot < 1) {
		return NULL;
	}
	return tb_rail_is_3v3(rail) ? &tb_slots[slot - 1].en3 : &tb_slots[slot - 1].en5;
}

/* Alert limit for a declared current: 10 % + 1 mA above it, kept under 95 % of the switch's minimum trip. */
uint32_t tb_rail_alert_ua(int rail, uint32_t declared_ma)
{
	static const uint32_t trip[TB_RAIL_COUNT][3] = TB_RAIL_TRIP_MA;
	uint32_t ua = declared_ma * 1100u + 1000u;
	uint32_t cap = trip[rail][0] * 950u;

	return MIN(ua, cap);
}

int tb_rail_on(int rail, uint32_t declared_ma, enum tb_refusal *why)
{
	const struct gpio_dt_spec *en = en_of(rail);
	const struct tb_mon *mon = tb_mon_for_rail(rail);
	int slot = tb_rail_slot(rail);
	enum tb_refusal r;
	int err;

	*why = TB_BUDGET_OK;
	if (en == NULL) {
		*why = TB_REFUSE_BAD_RAIL;
		return -EINVAL;
	}
	if (slot >= 1 && !(tb.present & BIT(slot - 1))) {
		return -ENODEV; /* PRESENT_N reads high: no coupon (SPEC §3.5) */
	}
	r = tb_budget_check(&tb.budget, rail, declared_ma);
	if (r != TB_BUDGET_OK) {
		*why = r;
		return -EPERM;
	}
	if (mon != NULL) {
		err = tb_mon_set_alert(mon, tb_rail_alert_ua(rail, declared_ma));
		if (err != 0) {
			return err; /* no monitor, no rail */
		}
	}
	if (slot >= 1 && (tb.bus_closed & BIT(slot - 1))) {
		/* SPEC §3.5: "close the slot's bus switch only after its rails are up". The caller closes it again
		 * once this rail has settled (tb_slot_on, the self-test). */
		err = tb_slot_bus(slot, false);
		if (err != 0) {
			return err;
		}
	}
	err = gpio_pin_set_dt(en, 1);
	if (err != 0) {
		return err;
	}
	(void)tb_budget_enable(&tb.budget, rail, declared_ma);
	tb.on_since_ms[rail] = k_uptime_get();
	if (slot >= 1 && tb_rail_is_3v3(rail)) {
		(void)gpio_pin_set_dt(&tb_slots[slot - 1].led, 1);
	}
	tb_ev("kind=rail_on rail=%s declared_ma=%u", tb_rail_name(rail), declared_ma);
	return 0;
}

static void hw_off(uint32_t mask, const char *reason)
{
	/* Per slot in SPEC §3.5's order: the bus switch open before either rail goes down ("open it before they go
	 * down"; it stays open until the slot is brought up again), the slot lines idle and the mux deselected when
	 * its 3.3 V goes, then 5 V, then 3.3 V. */
	for (int slot = TB_SLOTS; slot >= 1; slot--) {
		const struct tb_slot_hw *h = &tb_slots[slot - 1];
		bool off3 = mask & TB_RAIL_BIT(h->rail3);
		bool off5 = mask & TB_RAIL_BIT(h->rail5);

		if (off3 || off5) {
			(void)tb_slot_bus(slot, false);
		}
		if (off3) {
			(void)tb_slot_lines(slot, false);
			(void)tb_mux_deselect();
		}
		if (off5 || off3) {
			(void)gpio_pin_set_dt(&h->en5, 0);
		}
		if (off3) {
			(void)gpio_pin_set_dt(&h->en3, 0);
			(void)gpio_pin_set_dt(&h->led, 0);
			tb.desc_err[slot - 1] = 1; /* unpowered: the descriptor must be read again */
		}
	}
	if (mask & TB_RAIL_BIT(TB_RAIL_5V_KVM)) {
		(void)gpio_pin_set_dt(&tb_sig.en_5v_kvm, 0);
	}
	for (int r = 0; r < TB_RAIL_COUNT; r++) {
		if (mask & TB_RAIL_BIT(r)) {
			const struct tb_mon *mon = tb_mon_for_rail(r);

			if (mon != NULL) {
				(void)tb_mon_set_alert(mon, 0);
			}
			tb_ev("kind=rail_off rail=%s reason=%s", tb_rail_name(r), reason);
		}
	}
}

void tb_apply_budget_off(uint32_t mask, const char *reason)
{
	if (mask != 0) {
		hw_off(mask, reason);
	}
}

uint32_t tb_rails_off(uint32_t mask, const char *reason)
{
	uint32_t off = 0;

	mask &= TB_RAIL_MASK_ALL;
	for (int r = 0; r < TB_RAIL_COUNT; r++) {
		if (mask & TB_RAIL_BIT(r)) {
			off |= tb_budget_off_mask(&tb.budget, r);
		}
	}
	/* Switch off what the firmware believes is on, and also what it was asked to (a rail left on by a
	 * failed sequence is never "not on" for the hardware). */
	hw_off(off | mask, reason);
	for (int r = 0; r < TB_RAIL_COUNT; r++) {
		if (off & TB_RAIL_BIT(r)) {
			(void)tb_budget_disable(&tb.budget, r);
		}
	}
	return off | mask;
}

int tb_restore(struct tb_restore_report *rep)
{
	static const uint16_t safe_out[TB_EXP_COUNT] = TB_EXP_SAFE_OUTPUT;
	static const uint16_t safe_cfg[TB_EXP_COUNT] = TB_EXP_SAFE_CONFIG;
	static const uint16_t out_mask[TB_EXP_COUNT] = TB_EXP_OUTPUT_MASK;
	int err = 0;

	memset(rep, 0, sizeof(*rep));
	/* The mux first: a channel left on joins I2C4's pull-ups to an unpowered slot's (SPEC §3.5). */
	rep->mux_err = tb_mux_deselect();
	/* Slot lines idle, then every bus switch open, then the rails off, 5 V first. */
	for (int slot = 1; slot <= TB_SLOTS; slot++) {
		err |= tb_slot_lines(slot, false);
	}
	err |= cfg(&tb_sig.slot_sync, GPIO_OUTPUT_INACTIVE);
	err |= cfg(&tb_sig.rig_mark, GPIO_OUTPUT_INACTIVE);
	err |= cfg(&tb_sig.rig_trig, GPIO_INPUT);
	for (int slot = 1; slot <= TB_SLOTS; slot++) {
		err |= cfg(&tb_slots[slot - 1].busen, GPIO_OUTPUT_INACTIVE);
	}
	tb.bus_closed = 0;
	for (int slot = 1; slot <= TB_SLOTS; slot++) {
		err |= cfg(&tb_slots[slot - 1].en5, GPIO_OUTPUT_INACTIVE);
	}
	err |= cfg(&tb_sig.en_5v_kvm, GPIO_OUTPUT_INACTIVE);
	for (int slot = 1; slot <= TB_SLOTS; slot++) {
		err |= cfg(&tb_slots[slot - 1].en3, GPIO_OUTPUT_INACTIVE);
		err |= cfg(&tb_slots[slot - 1].led, GPIO_OUTPUT_INACTIVE);
	}
	/* The KVM coupon held in reset; the mux pulsed through its RESET and deselected again. */
	err |= cfg(&tb_sig.kvm_rst, GPIO_OUTPUT_ACTIVE);
	err |= cfg(&tb_sig.mux_rst, GPIO_OUTPUT_ACTIVE);
	k_busy_wait(10);
	err |= gpio_pin_set_dt(&tb_sig.mux_rst, 0);
	k_busy_wait(10);
	rep->mux_err |= tb_mux_deselect();
	rep->mux_err |= tb_mux_read(&rep->mux_ctrl);
	for (int r = 0; r < TB_RAIL_COUNT; r++) {
		(void)tb_budget_disable(&tb.budget, r);
	}

	/* Read every expander back and compare with the generated restore state. */
	rep->ok = err == 0 && rep->mux_err == 0 && rep->mux_ctrl == 0;
	for (int i = 0; i < TB_EXP_COUNT; i++) {
		int e = tb_exp_read(i, 0x02, &rep->out[i]);

		e |= tb_exp_read(i, 0x06, &rep->cfg[i]);
		rep->exp_ok[i] = e == 0 && rep->cfg[i] == safe_cfg[i] &&
				 (rep->out[i] & out_mask[i]) == (safe_out[i] & out_mask[i]);
		rep->ok &= rep->exp_ok[i];
		err |= e;
	}
	rep->err = err ? -EIO : 0;
	return rep->err;
}

static void budget_cfg(struct tb_budget_cfg *c)
{
	static const uint32_t rule[TB_RAIL_COUNT] = TB_RAIL_RULE_MA;

	memset(c, 0, sizeof(*c));
	c->unconfigured_ma = tb_sig.vsys_unconf_ma;
	c->vsys_max_ma = tb_sig.vsys_max_ma;
	c->slot_ldo_ma = tb_sig.ldo_ma;
	c->base_ma = tb_sig.base_ma;
	c->src_ma[TB_SRC_PENDING] = TB_TYPEC_BUDGET_DEFAULT_MA;
	c->src_ma[TB_SRC_DEFAULT] = TB_TYPEC_BUDGET_DEFAULT_MA;
	c->src_ma[TB_SRC_1A5] = TB_TYPEC_BUDGET_1A5_MA;
	c->src_ma[TB_SRC_3A0] = TB_TYPEC_BUDGET_3A0_MA;
	c->src_ma[TB_SRC_ACCESSORY] = TB_TYPEC_BUDGET_ACCESSORY_MA;
	c->src_ma[TB_SRC_NOT_ATTACHED] = TB_TYPEC_BUDGET_NOT_ATTACHED_MA;
	c->src_ma[TB_SRC_UNREADABLE] = TB_TYPEC_BUDGET_UNREADABLE_MA;
	memcpy(c->rule_ma, rule, sizeof(rule));
}

int tb_board_init(void)
{
	struct tb_budget_cfg c;
	uint16_t in;
	int err;

	for (int s = 0; s < TB_SLOTS; s++) {
		tb.desc_err[s] = 1;
	}
	budget_cfg(&c);
	tb_budget_init(&tb.budget, &c);
	tb.boot_ms = k_uptime_get();
	for (int i = 0; i < TB_EXP_COUNT; i++) {
		if (!device_is_ready(tb_sig.exp[i])) {
			LOG_ERR("U_EXP%d not ready", i + 1);
		}
	}
	err = tb_restore(&tb.restore);
	if (tb_exp2_inputs(&in) == 0) {
		for (int s = 1; s <= TB_SLOTS; s++) {
			WRITE_BIT(tb.present, s - 1, tb_pin_active(in, &tb_slots[s - 1].present));
		}
	}
	return err;
}

/* The alternate channels of a slot (lane, adc, channel), from the devicetree. */
int tb_slot_alt(int slot, int i, uint8_t *lane, uint8_t *adc, uint8_t *ch)
{
	if (slot < 1 || slot > TB_SLOTS || i < 0 || 3 * i + 2 >= alt_len[slot - 1]) {
		return -ENOENT;
	}
	*lane = alt_tab[slot - 1][3 * i];
	*adc = alt_tab[slot - 1][3 * i + 1];
	*ch = alt_tab[slot - 1][3 * i + 2];
	return 0;
}
```

## src/board.h
```c
/*
 * The board service of the bring-up app: the hardware tables (from the kbd_testbed_a devicetree), the state
 * (budget, rails, slots, U_CC) and the sequences that change it (SPEC §3.5, §8.4).
 *
 * Locking: everything here that touches the hardware or tb_state runs with tb_lock held. Never print to a
 * shell with tb_lock held: a shell whose host does not read blocks the writer, and the board service must
 * always be able to switch rails off. Collect, unlock, then print.
 *
 * SPDX-License-Identifier: Apache-2.0
 */
#ifndef TB_BOARD_H_
#define TB_BOARD_H_

#include <stdbool.h>
#include <stdint.h>

#include <zephyr/drivers/adc.h>
#include <zephyr/drivers/gpio.h>
#include <zephyr/drivers/i2c.h>
#include <zephyr/kernel.h>

#include "tb/budget.h"
#include "tb/desc.h"
#include "tb/rails.h"
#include "tb_board_map.h"

struct tb_slot_hw {
	int n;
	struct adc_dt_spec lane[4];
	struct gpio_dt_spec g[6];
	struct gpio_dt_spec cs[2];
	struct gpio_dt_spec irq;
	bool irq_bkin;
	struct gpio_dt_spec present, en3, en5, busen, led;
	struct gpio_dt_spec pg5; /* port NULL when the 5 V rail has no power-good (S1-S4) */
	const struct device *i2c_ch;
	uint32_t rule3_ma, rule5_ma;
	uint32_t trip3_ma[3], trip5_ma[3];
	int rail3, rail5;
};

struct tb_signals {
	struct gpio_dt_spec exp_int, slot_fault, pm_alert, vsys_pg, s5_pg, usbc_int, kvm_present, mux_rst, kvm_rst,
		en_5v_kvm, slot_sync, rig_mark, rig_trig;
	struct i2c_dt_spec typec, mux;
	const struct device *exp[TB_EXP_COUNT];
	uint8_t exp_addr[TB_EXP_COUNT];
	const struct device *i2c_pm;
	uint32_t ldo_ma, base_ma, vsys_max_ma, vsys_unconf_ma, kvm_rule_ma;
	uint32_t kvm_trip_ma[3];
};

extern const struct tb_slot_hw tb_slots[TB_SLOTS];
extern const struct tb_signals tb_sig;

/* What the boot hook found in the expanders and the mux before the drivers touched them (main.c). */
struct tb_boot_snapshot {
	bool valid;
	int err[TB_EXP_COUNT];
	uint16_t in[TB_EXP_COUNT], out[TB_EXP_COUNT], cfg[TB_EXP_COUNT];
	int mux_err;
	uint8_t mux_ctrl;
	uint32_t reset_cause;
	/* per bus: 0 answered, 1 answered after a bus recovery, < 0 the error (main.c bus_check()) */
	int recover_i2c1, recover_i2c4;
};
extern struct tb_boot_snapshot tb_boot;

struct tb_restore_report {
	int err;
	uint16_t out[TB_EXP_COUNT], cfg[TB_EXP_COUNT];
	bool exp_ok[TB_EXP_COUNT];
	uint8_t mux_ctrl;
	int mux_err;
	bool ok;
};

struct tb_state {
	struct tb_budget budget;
	int64_t on_since_ms[TB_RAIL_COUNT];
	uint8_t present;   /* bit n-1: PRESENT_N of slot n reads low (a coupon) */
	uint8_t bus_closed; /* bit n-1: slot n's bus switch closed */
	struct tb_desc desc[TB_SLOTS];
	int desc_err[TB_SLOTS]; /* tb_desc_err, or 1 = not read */
	/* U_CC */
	bool cc_decided, cc_ok;
	uint8_t cc_r08, cc_r09, cc_rev;
	int64_t boot_ms;
	/* a test in progress: the service skips fault and alert attribution on these rails until test_until */
	uint32_t test_rails;
	int64_t test_until_ms;
	struct tb_restore_report restore;
	uint32_t polls, faults_handled;
};

extern struct k_mutex tb_lock;
extern struct tb_state tb;

/* Boot: budget, the expander and mux restore, the monitors, the slot lines. */
int tb_board_init(void);
/* Every rail off, bus switches open, MCU slot lines high-impedance, the mux deselected. */
int tb_restore(struct tb_restore_report *rep);
int tb_mux_deselect(void);
int tb_mux_read(uint8_t *ctrl);

/* Raw expander registers (two bytes from reg, little-endian port 0 first). */
int tb_exp_read(int exp, uint8_t reg, uint16_t *val);
/* U_EXP2's input port, through its driver (clears its INT). */
int tb_exp2_inputs(uint16_t *raw);
/* Physical level of a pin of an expander's port value, and whether it is active (flags applied). */
bool tb_pin_level(uint16_t port, const struct gpio_dt_spec *s);
bool tb_pin_active(uint16_t port, const struct gpio_dt_spec *s);

/* Enable one rail (budget, order, presence checked). why gets the refusal. A closed bus switch of the slot is
 * opened first (SPEC §3.5); the caller closes it again once the rail is up. */
int tb_rail_on(int rail, uint32_t declared_ma, enum tb_refusal *why);
/* Turn rails off in SPEC §3.5's order: bus switch open, slot lines idle, mux deselected, 5 V, then 3.3 V. Also
 * marks them off in the budget and posts a rail_off event per rail. Returns the rails switched off. */
uint32_t tb_rails_off(uint32_t mask, const char *reason);
/* A slot's MCU lines for a powered slot (CS high, G low, IRQ input) or an unpowered one (high-impedance). */
int tb_slot_lines(int slot, bool powered);
int tb_slot_bus(int slot, bool closed);
bool tb_rail_settling(int rail);
/* The monitor's alert for a declared current: 10 % + 1 mA above it, under 95 % of the switch's minimum trip. */
uint32_t tb_rail_alert_ua(int rail, uint32_t declared_ma);

/* Apply a rail mask the budget marked off (it already updated its own state). */
void tb_apply_budget_off(uint32_t mask, const char *reason);

const struct tb_slot_hw *tb_slot_hw(int slot);
/* A hook after the firmware drives a slot's G-line or SYNC directly: nothing on hardware; the simulated board
 * (sim/world.c) re-evaluates its model there, since an emulated GPIO output has no callback. */
void tb_sim_sync(void);

/* The boot report (main.c), one record per call of line(). */
void tb_boot_report(void (*line)(void *ctx, const char *s), void *ctx);
/* The i-th alternate converter channel of a slot's lanes (devicetree alt-adc-channels); -ENOENT past the end. */
int tb_slot_alt(int slot, int i, uint8_t *lane, uint8_t *adc, uint8_t *ch);

#endif /* TB_BOARD_H_ */
```

## src/cdc_shell.c
```c
/*
 * A second shell instance on the CDC ACM UART, beside the board's USART1 shell. The shell UART backend's
 * transport API is public (include/zephyr/shell/shell_uart.h, Zephyr v4.5.0), so a second instance is the same
 * SHELL_UART_DEFINE / SHELL_DEFINE pair that subsys/shell/backends/shell_uart.c uses for the chosen one.
 *
 * SPDX-License-Identifier: Apache-2.0
 */
#include <zephyr/device.h>
#include <zephyr/devicetree.h>
#include <zephyr/logging/log.h>
#include <zephyr/shell/shell.h>
#include <zephyr/shell/shell_uart.h>

#include "cdc_shell.h"

SHELL_UART_DEFINE(tb_cdc_transport);
SHELL_DEFINE(tb_cdc_sh, "tb:cdc> ", &tb_cdc_transport, CONFIG_SHELL_BACKEND_SERIAL_LOG_MESSAGE_QUEUE_SIZE,
	     CONFIG_SHELL_BACKEND_SERIAL_LOG_MESSAGE_QUEUE_TIMEOUT, SHELL_FLAG_OLF_CRLF);

static bool started;

int tb_cdc_shell_start(void)
{
	const struct device *dev = DEVICE_DT_GET(DT_NODELABEL(cdc_acm_uart0));
	static const struct shell_backend_config_flags flags = SHELL_DEFAULT_BACKEND_CONFIG_FLAGS;
	int err;

	if (!device_is_ready(dev)) {
		return -ENODEV;
	}
	err = shell_init(&tb_cdc_sh, dev, flags, true, LOG_LEVEL_INF);
	if (err == 0) {
		started = true;
	}
	return err;
}

const struct shell *tb_cdc_shell(void)
{
	return started ? &tb_cdc_sh : NULL;
}
```

## src/cdc_shell.h
```c
/*
 * The second shell, on the CDC ACM function (the first is the board's zephyr,shell-uart, USART1).
 *
 * SPDX-License-Identifier: Apache-2.0
 */
#ifndef TB_CDC_SHELL_H_
#define TB_CDC_SHELL_H_

#include <errno.h>
#include <zephyr/shell/shell.h>

#if defined(CONFIG_BRINGUP_USB)
int tb_cdc_shell_start(void);
/* NULL until started. */
const struct shell *tb_cdc_shell(void);
#else
static inline int tb_cdc_shell_start(void)
{
	return -ENOTSUP;
}
static inline const struct shell *tb_cdc_shell(void)
{
	return NULL;
}
#endif

#endif /* TB_CDC_SHELL_H_ */
```

## src/coupon_test.h
```c
/*
 * The test-coupon self-test (see coupon_test.c).
 *
 * SPDX-License-Identifier: Apache-2.0
 */
#ifndef TB_COUPON_TEST_H_
#define TB_COUPON_TEST_H_

#include <stdbool.h>
#include <zephyr/shell/shell.h>

struct tb_st_opts {
	bool loads;  /* the G0 and G2 load steps, and the series resistance */
	bool climit; /* the G1 and G3 current-limit steps */
	bool force;  /* run on a coupon whose descriptor is not a test coupon's */
};

/* Prints "@tb step ..." per step and a final "@tb selftest ..."; takes tb_lock per step. */
int tb_selftest_run(const struct shell *sh, int slot, const struct tb_st_opts *o);

#endif /* TB_COUPON_TEST_H_ */
```

## src/descio.c
```c
/*
 * Coupon descriptor EEPROM access (see descio.h).
 *
 * SPDX-License-Identifier: Apache-2.0
 */
#include <string.h>

#include <zephyr/drivers/i2c.h>
#include <zephyr/kernel.h>

#include "board.h"
#include "descio.h"

#define CHUNK 32
#define WRITE_POLL_MS 10 /* the M24C02's write cycle is 5 ms max */

static int read_at(const struct device *bus, uint8_t addr, uint8_t *buf, size_t n)
{
	return i2c_write_read(bus, TB_I2C_ADDR_DESCRIPTOR, &addr, 1, buf, n);
}

int tb_descio_read(int slot, uint8_t *buf, size_t cap, size_t *len)
{
	const struct tb_slot_hw *h = tb_slot_hw(slot);
	size_t want = CHUNK, got = 0;
	int err, plen;

	*len = 0;
	if (h == NULL || cap < CHUNK) {
		return -EINVAL;
	}
	err = read_at(h->i2c_ch, 0, buf, CHUNK);
	if (err != 0) {
		return err;
	}
	got = CHUNK;
	plen = tb_desc_peek_length(buf, got);
	if (plen > 0) {
		want = MIN((size_t)plen, cap);
	}
	while (got < want) {
		size_t n = MIN((size_t)CHUNK, want - got);

		err = read_at(h->i2c_ch, (uint8_t)got, &buf[got], n);
		if (err != 0) {
			return err;
		}
		got += n;
	}
	*len = got;
	return 0;
}

int tb_descio_load(int slot, uint8_t *raw, size_t cap, size_t *len)
{
	int err = tb_descio_read(slot, raw, cap, len);
	int perr;

	if (err != 0) {
		tb.desc_err[slot - 1] = TB_DESCIO_BUS_ERR;
		return TB_DESCIO_BUS_ERR;
	}
	perr = tb_desc_parse(raw, *len, &tb.desc[slot - 1]);
	tb.desc_err[slot - 1] = perr;
	return perr;
}

int tb_descio_write(int slot, const uint8_t *buf, size_t len)
{
	const struct tb_slot_hw *h = tb_slot_hw(slot);
	uint8_t page[1 + TB_DESC_EEPROM_PAGE];

	if (h == NULL || len > TB_DESC_MAX_LEN) {
		return -EINVAL;
	}
	for (size_t off = 0; off < len; off += TB_DESC_EEPROM_PAGE) {
		size_t n = MIN((size_t)TB_DESC_EEPROM_PAGE, len - off);
		int64_t until;
		int err;

		page[0] = (uint8_t)off; /* page-aligned: a page write never rolls over */
		memcpy(&page[1], &buf[off], n);
		err = i2c_write(h->i2c_ch, page, 1 + n, TB_I2C_ADDR_DESCRIPTOR);
		if (err != 0) {
			return err;
		}
		/* ACK polling: the device does not acknowledge its address during the write cycle. */
		until = k_uptime_get() + WRITE_POLL_MS;
		do {
			k_msleep(1);
			err = i2c_write(h->i2c_ch, page, 1, TB_I2C_ADDR_DESCRIPTOR);
		} while (err != 0 && k_uptime_get() < until);
		if (err != 0) {
			return -ETIMEDOUT;
		}
	}
	return 0;
}
```

## src/descio.h
```c
/*
 * The coupon descriptor EEPROM (M24C02 at 0x50 on the slot's own mux channel; SPEC §4.6): read, parse, and
 * write (16-byte pages, 5 ms write cycle, ACK polling: ST DocID024020 §5.1.2). Callers hold tb_lock and power
 * the slot's +3V3 first.
 *
 * SPDX-License-Identifier: Apache-2.0
 */
#ifndef TB_DESCIO_H_
#define TB_DESCIO_H_

#include <stddef.h>
#include <stdint.h>

#include "tb/desc.h"

/* Read the descriptor's bytes (header first, then as many as it declares). *len: bytes read. */
int tb_descio_read(int slot, uint8_t *buf, size_t cap, size_t *len);
/* Read and parse into tb.desc[slot - 1] and tb.desc_err[slot - 1]; returns the tb_desc_err, or a negative
 * errno below TB_DESC_ERR_SPACE for a bus error. */
int tb_descio_load(int slot, uint8_t *raw, size_t cap, size_t *len);
int tb_descio_write(int slot, const uint8_t *buf, size_t len);

#define TB_DESCIO_BUS_ERR (-100)

#endif /* TB_DESCIO_H_ */
```

## src/events.c
```c
/*
 * Event ring and printer (see events.h).
 *
 * SPDX-License-Identifier: Apache-2.0
 */
#include <stdarg.h>
#include <stdio.h>
#include <string.h>

#include <zephyr/kernel.h>
#include <zephyr/shell/shell_uart.h>
#include <zephyr/spinlock.h>

#include "cdc_shell.h"
#include "events.h"

#define EV_TEXT 120

struct ev {
	uint32_t seq;
	uint32_t t_ms;
	char text[EV_TEXT];
};

static struct ev ring[CONFIG_BRINGUP_EVENT_RING];
static uint32_t next_seq = 1;
static struct k_spinlock lock;
static K_SEM_DEFINE(ev_sem, 0, 1);

void tb_ev(const char *fmt, ...)
{
	struct ev e;
	va_list ap;
	k_spinlock_key_t key;

	va_start(ap, fmt);
	vsnprintf(e.text, sizeof(e.text), fmt, ap);
	va_end(ap);
	e.t_ms = k_uptime_get_32();
	key = k_spin_lock(&lock);
	e.seq = next_seq++;
	ring[e.seq % ARRAY_SIZE(ring)] = e;
	k_spin_unlock(&lock, key);
	k_sem_give(&ev_sem);
}

uint32_t tb_ev_next_seq(void)
{
	k_spinlock_key_t key = k_spin_lock(&lock);
	uint32_t s = next_seq;

	k_spin_unlock(&lock, key);
	return s;
}

static bool get(uint32_t seq, struct ev *out)
{
	k_spinlock_key_t key = k_spin_lock(&lock);
	bool ok = seq < next_seq && ring[seq % ARRAY_SIZE(ring)].seq == seq;

	if (ok) {
		*out = ring[seq % ARRAY_SIZE(ring)];
	}
	k_spin_unlock(&lock, key);
	return ok;
}

static void print_one(const struct shell *sh, const struct ev *e)
{
	if (sh != NULL) {
		shell_fprintf(sh, SHELL_NORMAL, "@tb ev seq=%u t_ms=%u %s\n", e->seq, e->t_ms, e->text);
	}
}

int tb_ev_dump(const struct shell *sh, uint32_t since)
{
	uint32_t end = tb_ev_next_seq();
	uint32_t first = end > ARRAY_SIZE(ring) ? end - ARRAY_SIZE(ring) : 1;
	struct ev e;
	int n = 0;

	for (uint32_t s = MAX(since, first); s < end; s++) {
		if (get(s, &e)) {
			print_one(sh, &e);
			n++;
		}
	}
	return n;
}

static void printer(void *a, void *b, void *c)
{
	uint32_t printed = 1;

	ARG_UNUSED(a);
	ARG_UNUSED(b);
	ARG_UNUSED(c);
	for (;;) {
		struct ev e;
		uint32_t end;

		k_sem_take(&ev_sem, K_FOREVER);
		end = tb_ev_next_seq();
		if (end > printed + ARRAY_SIZE(ring)) {
			printed = end - ARRAY_SIZE(ring);
		}
		for (; printed < end; printed++) {
			if (get(printed, &e)) {
				/* Either shell may block while its host does not read; this thread may wait. */
				print_one(shell_backend_uart_get_ptr(), &e);
				print_one(tb_cdc_shell(), &e);
			}
		}
	}
}

K_THREAD_DEFINE(tb_ev_printer, 2048, printer, NULL, NULL, NULL, K_LOWEST_APPLICATION_THREAD_PRIO, 0, 0);

void tb_ev_start(void)
{
	k_sem_give(&ev_sem);
}
```

## src/events.h
```c
/*
 * Asynchronous events (PROTOCOL.md "Events"): a ring the board service writes without blocking, and a printer
 * thread that copies new entries to both shells. A shell that is busy or not read may miss a line; the ring
 * keeps the last CONFIG_BRINGUP_EVENT_RING, and "tb ev" replays them by sequence number.
 *
 * SPDX-License-Identifier: Apache-2.0
 */
#ifndef TB_EVENTS_H_
#define TB_EVENTS_H_

#include <stdint.h>
#include <zephyr/shell/shell.h>

/* Post "@tb ev seq=<n> t_ms=<t> <text>"; text is "kind=<kind> key=value ...". Never blocks. */
void tb_ev(const char *fmt, ...) __printf_like(1, 2);
/* Replay events with seq >= since on one shell. Returns how many. */
int tb_ev_dump(const struct shell *sh, uint32_t since);
uint32_t tb_ev_next_seq(void);
void tb_ev_start(void);

#endif /* TB_EVENTS_H_ */
```

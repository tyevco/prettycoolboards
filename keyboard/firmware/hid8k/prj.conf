## CMakeLists.txt
```
# hid8k: 8 kHz HID proof for the NUCLEO-U5A5ZJ-Q
# SPDX-License-Identifier: Apache-2.0

cmake_minimum_required(VERSION 3.20.0)
find_package(Zephyr REQUIRED HINTS $ENV{ZEPHYR_BASE})
project(hid8k)

target_sources(app PRIVATE
  src/main.c
  src/hid8k.c
  src/cdc_console.c
  src/usb_device.c
)

# Stricter than Zephyr's defaults, for this app's own sources only. -Wno-type-limits: with
# -Wextra, Zephyr v4.5.0's own usbd_msg.h (usbd_msg_type_string(), "type >= 0" on an enum)
# would warn in every file that includes usbd.h.
target_compile_options(app PRIVATE -Wextra -Wshadow -Wno-type-limits)
```

## Kconfig
```
# hid8k: 8 kHz HID proof for the NUCLEO-U5A5ZJ-Q
# SPDX-License-Identifier: Apache-2.0

menu "hid8k: 8 kHz HID proof"

config HID8K_SIM
	bool "Build for the native_sim USB simulation (sim/)"
	depends on ARCH_POSIX
	help
	  Set only by sim/prj.conf, never for the board. Replaces the three
	  STM32-only pieces (the DWT cycle counter, the OTG_HS frame number and
	  the HS PHY tuning) with Zephyr's cycle counter, so that the rest of
	  the firmware (descriptors, usbd_hid setup, pacing, report layout, CDC
	  console, stats thread) runs unchanged against Zephyr's virtual USB
	  host controller. The board build is not affected.

config HID8K_USB_VID
	hex "USB vendor ID"
	default 0x1209
	help
	  Default 0x1209 with PID 0x0001: the pid.codes test PID, reserved for
	  private testing. It is not universally unique and must not be used on
	  any device that is redistributed, sold or manufactured. Bench use only.

config HID8K_USB_PID
	hex "USB product ID"
	default 0x0001
	help
	  See HID8K_USB_VID. Change the pair only to another test ID, never to
	  one that belongs to someone else's product.

config HID8K_USB_MANUFACTURER
	string "USB manufacturer string"
	default "prettycoolboards bench test"

config HID8K_USB_PRODUCT
	string "USB product string"
	default "hid8k 8 kHz HID proof (bench only)"

config HID8K_USB_MAX_POWER
	int "bMaxPower in 2 mA units"
	range 0 250
	default 50
	help
	  The configuration is declared self-powered (the Nucleo is powered from
	  its ST-LINK USB on the bench); 50 (100 mA) is a conservative
	  declaration, not a measurement.

config HID8K_QUEUE_DEPTH
	int "HID reports kept queued on the IN endpoint"
	range 1 4
	default 2
	help
	  The input_report_done callback tops the queue up to this many
	  reports. With 2, one report is armed in the controller and one waits
	  behind it, so the UDC driver arms the next report as soon as a
	  transfer completes, without waiting for the USB stack thread.
	  CONFIG_USBD_HID_IN_BUF_COUNT must be at least this plus one.

config HID8K_LOG_PERIOD_MS
	int "Stats line period on the CDC console (ms)"
	range 10 20000
	default 1000
	help
	  One stats line per period. Shorter periods put more traffic on the
	  CDC ACM path; the window rate is computed from the cycle counter,
	  which wraps every 26.8 s at 160 MHz, hence the upper limit.

config HID8K_HIST_PERIOD_S
	int "Cumulative histogram dump period (s), 0 = only on the hist command"
	range 0 3600
	default 10

config HID8K_CDC_HEAVY_BPS
	int "Filler bytes per second in heavy CDC mode"
	range 0 4000000
	default 100000
	help
	  In heavy mode (the "heavy" command, or HID8K_CDC_HEAVY_AT_BOOT) the
	  stats thread writes this many bytes per second of numbered filler
	  lines to the CDC console, on top of the stats lines.

config HID8K_CDC_HEAVY_AT_BOOT
	bool "Start in heavy CDC mode"

config HID8K_CDC_RING_SIZE
	int "CDC console transmit ring size (bytes)"
	range 1024 16384
	default 8192

config HID8K_CDC_CHUNK
	int "Most bytes handed to the CDC class per callback run"
	range 64 16384
	default 512
	help
	  The CDC ACM callback runs in a cooperative work queue, which the USB
	  stack threads cannot preempt. Bounding each run bounds how long it
	  can hold them off.

config HID8K_FRAME_NUMBER
	bool "Read the (micro)frame number from the OTG_HS register"
	depends on !HID8K_SIM
	help
	  Zephyr's USB device stack does not expose the SOF or (micro)frame
	  number: the SOF event carries none, and hid_device_ops.sof has no
	  argument. With this option the firmware reads OTG_HS DSTS.FNSOF
	  directly (outside the stack, read-only) in the completion callback
	  and at each submit, and sets HID8K_FLAG_FN_VALID in the stats report.
	  The host tool then counts microframes without a completion. Off by
	  default because it goes around the stack.

config HID8K_PHY_TUNER2
	bool "Write the HS PHY's recommended TUNER2 values before the PHY is enabled"
	depends on !HID8K_SIM
	help
	  RM0456 Rev 7 section 15.2.3 sets SYSCFG_OTGHSPHYTUNER2 to
	  COMPDISTUNE = 010 (disconnect threshold +5.9 %) and SQRXTUNE = 000
	  (squelch threshold +15 %), the recommended values, before it sets
	  the PHY's EN bit. Zephyr v4.5.0 never writes TUNER2, so the register
	  keeps its reset defaults (0 %). With this option main() writes the
	  two fields through the LL read-modify-write setters before
	  usbd_init(), where Zephyr's UDC driver sets EN. Off by default, so
	  the default build is what Zephyr does upstream; bring-up runs both.

config HID8K_MIRROR_TO_CONSOLE
	bool "Mirror stats lines to the board console (ST-LINK VCP), at most 1/s"
	default y

endmenu

source "Kconfig.zephyr"
```

## prj.conf
```kconfig
# hid8k: 8 kHz HID proof for the NUCLEO-U5A5ZJ-Q (Zephyr v4.5.0)

# The new USB device stack (device_next); high speed on usbotg_hs is its default on this board.
CONFIG_USB_DEVICE_STACK_NEXT=y
CONFIG_CDC_ACM_SERIAL_INITIALIZE_AT_BOOT=n

# HID: the IN pool needs one buffer more than the reports kept queued (CONFIG_HID8K_QUEUE_DEPTH),
# because usbd_hid calls input_report_done before it frees the completed buffer.
CONFIG_USBD_HID_IN_BUF_COUNT=4

# Event queue margins (defaults 8 and 10), not a measured need. At 8000 completions/s plus CDC
# traffic a short stall of the cooperative threads must not overrun them. An overrun of the
# STM32 UDC driver's queue loses a DataIn event (udc_stm32.c:759-772), which would leave the
# HID endpoint waiting forever; that one is set in boards/nucleo_u5a5zj_q.conf, so this file
# also builds for the native_sim simulation (sim/). The stack's own queue keeps transfer
# completions on a list (usbd_core.c:39-47), so an overrun there delays them but cannot lose
# one; it can still drop a bus event (reset, suspend), hence the margin.
CONFIG_USBD_MAX_UDC_MSG=32

# CDC ACM console (interrupt-driven UART API).
CONFIG_SERIAL=y
CONFIG_UART_LINE_CTRL=y

# User button -> keyboard report.
CONFIG_GPIO=y
CONFIG_INPUT=y
CONFIG_INPUT_MODE_SYNCHRONOUS=y

# Logs and printk go to the board console (USART1, the ST-LINK virtual COM port), not to the
# USB link under test.
CONFIG_LOG=y
CONFIG_USBD_LOG_LEVEL_WRN=y
CONFIG_USBD_HID_LOG_LEVEL_WRN=y
CONFIG_UDC_DRIVER_LOG_LEVEL_WRN=y
CONFIG_USBD_CDC_ACM_LOG_LEVEL_WRN=y

CONFIG_MAIN_STACK_SIZE=2048
```

## boards/nucleo_u5a5zj_q.conf
```kconfig
# hid8k on the NUCLEO-U5A5ZJ-Q: added to prj.conf by Zephyr for this board only.

# The STM32 UDC driver's event queue (default 8), raised as a margin, not a measured need: an
# overrun drops a DataIn event (udc_stm32.c:759-772, "UDC Message queue overrun"), which would
# leave the HID endpoint waiting forever. See prj.conf for the stack's own queue.
CONFIG_UDC_STM32_MAX_QMESSAGES=32
```

## boards/nucleo_u5a5zj_q.overlay
```dts
/*
 * hid8k on the NUCLEO-U5A5ZJ-Q. The board file already enables the OTG_HS controller with
 * its embedded high-speed PHY (zephyr_udc0: &usbotg_hs, &otghs_phy). The HID and CDC ACM nodes
 * are in ../dts/hid8k_usb.dtsi, which the native_sim simulation (sim/) includes too.
 *
 * SPDX-License-Identifier: Apache-2.0
 */

#include "../dts/hid8k_usb.dtsi"
```

## dts/hid8k_usb.dtsi
```dts
/*
 * hid8k: the two USB functions, shared by the board overlay (boards/nucleo_u5a5zj_q.overlay) and
 * the native_sim simulation (sim/boards/), so that the simulation tests the same HID node: the
 * bInterval and wMaxPacketSize under test come from here. Include it after zephyr_udc0 is defined.
 *
 * SPDX-License-Identifier: Apache-2.0
 */

/ {
	hid8k_hid: hid8k_hid {
		compatible = "zephyr,hid-device";
		label = "hid8k keyboard and stats";
		/* No boot protocol: report IDs, and one interface for both collections. */
		protocol-code = "none";
		/* 64 bytes keeps wMaxPacketSize 64 and the simple interface (no alternate). */
		in-report-size = <64>;
		/* USB_HS_INT_EP_INTERVAL(125) = 1: one IN transaction per 125 us microframe. */
		in-polling-period-us = <125>;
	};
};

&zephyr_udc0 {
	cdc_acm_uart0: cdc_acm_uart0 {
		compatible = "zephyr,cdc-acm-uart";
		label = "hid8k console";
	};
};
```

## src/main.c
```c
/*
 * hid8k: 8 kHz HID proof for the NUCLEO-U5A5ZJ-Q (keyboard/docs/mcu.md, condition 2).
 *
 * main() brings the device up, then becomes the stats thread: once per log period it takes a
 * snapshot of the firmware-side statistics and prints one line over the CDC ACM console, and
 * in heavy mode it also streams filler text there to load the CDC path.
 *
 * SPDX-License-Identifier: Apache-2.0
 */

#include <string.h>

#include <zephyr/device.h>
#include <zephyr/devicetree.h>
#include <zephyr/drivers/gpio.h>
#include <zephyr/kernel.h>
#include <zephyr/sys/atomic.h>
#include <zephyr/sys/printk.h>
#include <zephyr/sys/util.h>

#if !defined(CONFIG_HID8K_SIM)
#include <stm32_ll_bus.h>
#include <stm32_ll_system.h>
#endif

#include "cdc_console.h"
#include "hid8k.h"
#include "hid8k_report.h"
#include "usb_device.h"

#define HEAVY_TICK_MS  10
#define IDLE_TICK_MS   100
#define MIRROR_MIN_MS  1000
#define FILL_LINE_LEN  64U

static const struct gpio_dt_spec led = GPIO_DT_SPEC_GET_OR(DT_ALIAS(led0), gpios, {0});

/* Requests from the CDC command callback (CDC work queue), served by the stats thread. */
static atomic_t req_heavy = ATOMIC_INIT(-1); /* -1 none, 0 normal, 1 heavy */
static atomic_t req_reset;
static atomic_t req_hist;
static atomic_t req_help;
static atomic_t req_unknown;

/* Large enough for the cumulative histogram with every bucket at its widest (about 830 B). */
static char line[1024];

static void on_command(const char *const cmd)
{
	if (strcmp(cmd, "heavy") == 0) {
		atomic_set(&req_heavy, 1);
	} else if (strcmp(cmd, "normal") == 0) {
		atomic_set(&req_heavy, 0);
	} else if (strcmp(cmd, "reset") == 0) {
		atomic_set(&req_reset, 1);
	} else if (strcmp(cmd, "hist") == 0) {
		atomic_set(&req_hist, 1);
	} else if (strcmp(cmd, "help") == 0 || strcmp(cmd, "?") == 0) {
		atomic_set(&req_help, 1);
	} else {
		atomic_inc(&req_unknown);
	}
}

static void cdc_puts(const char *const s)
{
	(void)cdc_console_write(s, strlen(s));
}

/*
 * The window measured by the cycle counter must match the one measured by the kernel's
 * uptime (both run from HCLK): if not, the counter stopped (a debug probe rewrote DEMCR) or
 * cpu_hz is wrong, and every timestamp in the stats reports is suspect. Tolerance: 2 ms for
 * the uptime's millisecond steps, plus 1 %.
 */
static bool cycles_consistent(const uint32_t window_cycles, const int64_t window_ms,
			      const uint32_t cpu_hz)
{
	const int64_t cyc_ms = (int64_t)window_cycles / (int64_t)(cpu_hz / 1000U);
	const int64_t diff = cyc_ms > window_ms ? cyc_ms - window_ms : window_ms - cyc_ms;

	return diff <= 2 + window_ms / 100;
}

/* Microseconds x 10 from cycles. */
static uint32_t us_x10(const uint64_t cycles, const uint32_t cpu_hz)
{
	return (uint32_t)((cycles * 10000000ULL) / cpu_hz);
}

static const char *usb_state_name(const enum hid8k_usb_state s)
{
	switch (s) {
	case HID8K_USB_CONFIGURED:
		return "cfg";
	case HID8K_USB_SUSPENDED:
		return "susp";
	case HID8K_USB_ADDRESSED:
		return "addr";
	default:
		return "dflt";
	}
}

/* Sum histogram buckets [lo, hi) (bucket indices). */
static uint32_t hist_sum(const struct hid8k_stats *const s, const unsigned int lo,
			 const unsigned int hi)
{
	uint32_t n = 0U;

	for (unsigned int i = lo; i < hi && i < HID8K_HIST_SLOTS; i++) {
		n += s->hist[i];
	}

	return n;
}

static int format_stats(const struct hid8k_snapshot *const snap, const uint32_t window_cycles,
			const bool heavy, const bool cyc_ok)
{
	const struct hid8k_stats *const w = &snap->win;
	const uint32_t cpu_hz = hid8k_cpu_hz();
	const uint32_t rate_x10 = window_cycles == 0U ? 0U :
		(uint32_t)(((uint64_t)w->completions * cpu_hz * 10U) / window_cycles);
	const uint32_t imin = w->intervals ? us_x10(w->interval_min, cpu_hz) : 0U;
	const uint32_t iavg = w->intervals ? us_x10(w->interval_sum / w->intervals, cpu_hz) : 0U;
	const uint32_t imax = w->intervals ? us_x10(w->interval_max, cpu_hz) : 0U;
	const uint32_t cmin = w->submits ? w->cost_min : 0U;
	const uint32_t cavg = w->submits ? (uint32_t)(w->cost_sum / w->submits) : 0U;
	const char *note = "";

	if (!cyc_ok) {
		note = " CYCCNT-MISMATCH";
	} else if (snap->streaming && w->completions == 0U) {
		note = " NO-COMPLETIONS";
	} else if (!snap->streaming) {
		note = " not-streaming";
	}

	/* Bucket edges at 12.5 us: 8 = 100 us, 12 = 150, 15 = 187.5, 20 = 250. */
	return snprintk(line, sizeof(line),
			"hid8k t=%us usb=%s %s rate=%u.%u/s int_us=%u.%u/%u.%u/%u.%u "
			"late=%u hist[<100:%u 100-150:%u 150-187.5:%u 187.5-250:%u >=250:%u] "
			"submit_cyc=%u/%u/%u refused=%u busy=%u err=%d kbd=%u out=%u stall=%u "
			"cdc=%s q=%u drop=%u pend=%u%s\r\n",
			k_uptime_get_32() / 1000U, usb_state_name(hid8k_usb_state()),
			snap->high_speed ? "hs" : "fs", rate_x10 / 10U, rate_x10 % 10U,
			imin / 10U, imin % 10U, iavg / 10U, iavg % 10U, imax / 10U, imax % 10U,
			w->late, hist_sum(w, 0, 8), hist_sum(w, 8, 12), hist_sum(w, 12, 15),
			hist_sum(w, 15, 20), hist_sum(w, 20, HID8K_HIST_SLOTS), cmin, cavg,
			w->cost_max, w->refused, w->busy, snap->last_err, w->kbd, snap->outstanding,
			snap->kicks, heavy ? "heavy" : "normal", cdc_console_queued(), cdc_console_dropped(),
			cdc_console_pending(), note);
}

static void print_hist(const struct hid8k_snapshot *const snap)
{
	const struct hid8k_stats *const c = &snap->cum;
	const uint32_t cpu_hz = hid8k_cpu_hz();
	int len;

	len = snprintk(line, sizeof(line),
		       "hid8k hist since reset: n=%u late=%u max_us=%u.%u buckets(us:count)",
		       c->intervals, c->late,
		       c->intervals ? us_x10(c->interval_max, cpu_hz) / 10U : 0U,
		       c->intervals ? us_x10(c->interval_max, cpu_hz) % 10U : 0U);

	for (unsigned int i = 0; i < HID8K_HIST_SLOTS && len > 0 && len < (int)sizeof(line) - 32;
	     i++) {
		const uint32_t lo_x10 = i * HID8K_HIST_BUCKET_US_X10;

		if (c->hist[i] == 0U) {
			continue;
		}

		len += snprintk(&line[len], sizeof(line) - (size_t)len, " %s%u.%u:%u",
				i == HID8K_HIST_BUCKETS ? ">=" : "", lo_x10 / 10U, lo_x10 % 10U,
				c->hist[i]);
	}

	if (len > 0 && len < (int)sizeof(line) - 3) {
		len += snprintk(&line[len], sizeof(line) - (size_t)len, "\r\n");
		cdc_puts(line);
	}
}

static void print_help(void)
{
	cdc_puts("hid8k commands (one per line): heavy | normal | reset | hist | help\r\n");
	snprintk(line, sizeof(line),
		 "hid8k config: queue_depth=%d log_period_ms=%d heavy_bps=%d chunk=%d "
		 "frame_number=%s cpu_hz=%u\r\n",
		 CONFIG_HID8K_QUEUE_DEPTH, CONFIG_HID8K_LOG_PERIOD_MS, CONFIG_HID8K_CDC_HEAVY_BPS,
		 CONFIG_HID8K_CDC_CHUNK, IS_ENABLED(CONFIG_HID8K_FRAME_NUMBER) ? "on" : "off",
		 hid8k_cpu_hz());
	cdc_puts(line);
}

/* Heavy mode: owed bytes of filler, in fixed-length lines the host can count. */
static void write_filler(uint32_t bytes, uint32_t *const fill_seq)
{
	char fill[FILL_LINE_LEN + 1U];

	while (bytes >= FILL_LINE_LEN) {
		int n = snprintk(fill, sizeof(fill), "~fill %08x ", *fill_seq);

		memset(&fill[n], '.', FILL_LINE_LEN - 2U - (uint32_t)n);
		fill[FILL_LINE_LEN - 2U] = '\r';
		fill[FILL_LINE_LEN - 1U] = '\n';
		(void)cdc_console_write(fill, FILL_LINE_LEN);
		(*fill_seq)++;
		bytes -= FILL_LINE_LEN;
	}
}

/*
 * RM0456 Rev 7 section 15.2.3 brings the HS PHY up as: clocks on, CLKSEL, then
 * SYSCFG_OTGHSPHYTUNER2 with COMPDISTUNE = 010 (+5.9 %) and SQRXTUNE = 000 (+15 %), then EN.
 * Zephyr v4.5.0's stm32_u5otghs_phy_enable() (called from udc_stm32_init(), which usbd_init()
 * reaches) writes CLKSEL and EN but never TUNER2. With CONFIG_HID8K_PHY_TUNER2 the two fields
 * are written here, before usbd_init(). The LL setters modify only their own bits: TUNER2's
 * bits 31:15 are reserved and must keep their reset value, so never a 32-bit write.
 */
#if !defined(CONFIG_HID8K_SIM)
static void phy_tuner2_apply(void)
{
	if (!IS_ENABLED(CONFIG_HID8K_PHY_TUNER2)) {
		return;
	}
	LL_APB3_GRP1_EnableClock(LL_APB3_GRP1_PERIPH_SYSCFG);
	LL_SYSCFG_SetOTGPHYDisconnectThresholdAdjustment(LL_SYSCFG_OTGHSPHY_DISCONNECT_5_9PERCENT);
	LL_SYSCFG_SetOTGPHYSquelchThresholdAdjustment(LL_SYSCFG_OTGHSPHY_SQUELCH_15PERCENT);
}

/*
 * After usbd_init() the SYSCFG clock is on in both builds (the PHY driver enables it), so the
 * register reads back.
 */
static void phy_tuner2_report(void)
{
	const uint32_t tuner2 = SYSCFG->OTGHSPHYTUNER2;

	printk("hid8k: OTG_HS PHY TUNER2 = 0x%08x (COMPDISTUNE %u, SQRXTUNE %u; %s)\n",
	       (unsigned int)tuner2,
	       (unsigned int)((tuner2 & SYSCFG_OTGHSPHYTUNER2_COMPDISTUNE) >>
			      SYSCFG_OTGHSPHYTUNER2_COMPDISTUNE_Pos),
	       (unsigned int)((tuner2 & SYSCFG_OTGHSPHYTUNER2_SQRXTUNE) >>
			      SYSCFG_OTGHSPHYTUNER2_SQRXTUNE_Pos),
	       IS_ENABLED(CONFIG_HID8K_PHY_TUNER2) ? "RM0456 recommended values written"
						   : "Zephyr default, not written");
}
#else
/* native_sim (sim/): there is no PHY to tune. */
static void phy_tuner2_apply(void)
{
}

static void phy_tuner2_report(void)
{
}
#endif

int main(void)
{
	struct hid8k_snapshot snap;
	bool heavy = IS_ENABLED(CONFIG_HID8K_CDC_HEAVY_AT_BOOT);
	uint32_t prev_cycles;
	int64_t prev_uptime_ms;
	uint32_t fill_seq = 0U;
	uint64_t fill_owed_x1000 = 0U;
	int64_t now;
	int64_t last_tick;
	int64_t next_line;
	int64_t next_hist;
	int64_t next_mirror;
	bool led_on = false;
	int ret;

	printk("hid8k: 8 kHz HID proof, USB %04x:%04x. The default 1209:0001 is the pid.codes "
	       "test PID: not unique, for private bench testing only, never for a product.\n",
	       CONFIG_HID8K_USB_VID, CONFIG_HID8K_USB_PID);

	ret = hid8k_init(hid8k_usbd_context());
	if (ret != 0) {
		printk("hid8k: HID init failed (%d)\n", ret);
		return ret;
	}

	ret = cdc_console_init(on_command);
	if (ret != 0) {
		printk("hid8k: CDC console init failed (%d)\n", ret);
		return ret;
	}

	phy_tuner2_apply();

	ret = hid8k_usb_init();
	if (ret != 0) {
		printk("hid8k: USB init failed (%d)\n", ret);
		return ret;
	}
	phy_tuner2_report();

	ret = hid8k_usb_enable();
	if (ret != 0) {
		printk("hid8k: USB enable failed (%d)\n", ret);
		return ret;
	}

	if (led.port != NULL && gpio_is_ready_dt(&led)) {
		(void)gpio_pin_configure_dt(&led, GPIO_OUTPUT_INACTIVE);
	}

	hid8k_set_cdc_heavy(heavy);
	printk("hid8k: USB enabled; stats on the CDC ACM console every %d ms\n",
	       CONFIG_HID8K_LOG_PERIOD_MS);

	hid8k_take_snapshot(&snap, false);
	prev_cycles = snap.cycles;
	prev_uptime_ms = snap.uptime_ms;
	now = k_uptime_get();
	last_tick = now;
	next_line = now + CONFIG_HID8K_LOG_PERIOD_MS;
	next_hist = now + (int64_t)CONFIG_HID8K_HIST_PERIOD_S * 1000;
	next_mirror = now;

	while (true) {
		atomic_val_t want_heavy;
		bool reset;

		k_sleep(K_MSEC(heavy ? HEAVY_TICK_MS : MIN(CONFIG_HID8K_LOG_PERIOD_MS, IDLE_TICK_MS)));
		now = k_uptime_get();

		want_heavy = atomic_set(&req_heavy, -1);
		if (want_heavy >= 0 && (want_heavy != 0) != heavy) {
			heavy = want_heavy != 0;
			hid8k_set_cdc_heavy(heavy);
			fill_owed_x1000 = 0U;
			cdc_puts(heavy ? "hid8k mode=heavy\r\n" : "hid8k mode=normal\r\n");
		}

		if (atomic_set(&req_help, 0) != 0) {
			print_help();
		}

		if (atomic_set(&req_unknown, 0) != 0) {
			cdc_puts("hid8k unknown command (try: help)\r\n");
		}

		if (heavy) {
			fill_owed_x1000 += (uint64_t)CONFIG_HID8K_CDC_HEAVY_BPS * (uint64_t)(now - last_tick);
			write_filler((uint32_t)(fill_owed_x1000 / 1000U), &fill_seq);
			fill_owed_x1000 %= (uint64_t)FILL_LINE_LEN * 1000U;
		}
		last_tick = now;

		reset = atomic_set(&req_reset, 0) != 0;

		if (now >= next_line || reset) {
			const bool hist_now = atomic_set(&req_hist, 0) != 0 ||
					      (CONFIG_HID8K_HIST_PERIOD_S > 0 && now >= next_hist);
			uint32_t window_cycles;
			bool cyc_ok;
			int len;

			/* Print the histogram before a reset clears it. */
			hid8k_take_snapshot(&snap, reset);
			window_cycles = snap.cycles - prev_cycles;
			cyc_ok = cycles_consistent(window_cycles, snap.uptime_ms - prev_uptime_ms,
						   hid8k_cpu_hz());
			prev_cycles = snap.cycles;
			prev_uptime_ms = snap.uptime_ms;
			hid8k_cycle_counter_keepalive();
			/* Backstop: restart the HID stream if a refused submit left nothing queued. */
			hid8k_kick();

			len = format_stats(&snap, window_cycles, heavy, cyc_ok);
			if (len > 0) {
				cdc_puts(line);
				if (IS_ENABLED(CONFIG_HID8K_MIRROR_TO_CONSOLE) && now >= next_mirror) {
					printk("%s", line);
					next_mirror = now + MIRROR_MIN_MS;
				}
			}

			if (hist_now) {
				print_hist(&snap);
				next_hist = now + (int64_t)CONFIG_HID8K_HIST_PERIOD_S * 1000;
			}

			if (reset) {
				cdc_puts("hid8k stats reset\r\n");
			}

			if (led.port != NULL && snap.win.completions > 0U) {
				led_on = !led_on;
				(void)gpio_pin_set_dt(&led, led_on ? 1 : 0);
			}

			next_line += CONFIG_HID8K_LOG_PERIOD_MS;
			if (next_line <= now) {
				next_line = now + CONFIG_HID8K_LOG_PERIOD_MS;
			}
		}
	}

	return 0;
}
```

## src/cdc_console.c
```c
/*
 * hid8k: the CDC ACM console. Lines from the stats thread go through a ring buffer to the
 * CDC ACM UART's interrupt-driven API; host input is read a line at a time and handed to
 * the command callback.
 *
 * In Zephyr's device_next CDC ACM the "interrupt" callback runs in a work queue (the system
 * work queue unless CONFIG_USBD_CDC_ACM_WORKQUEUE), and uart_fifo_fill()/uart_fifo_read()
 * belong in that callback (with the dedicated work queue the class enforces it,
 * check_wq_ctx() in usbd_cdc_acm.c). That work queue is
 * cooperative, like the USB stack's own threads, so the callback copies at most
 * CONFIG_HID8K_CDC_CHUNK bytes per run and then returns; the class resubmits its work item
 * while TX stays enabled and has space, and the work queue yields between items.
 *
 * The ring has one producer (cdc_console_write(), called only from the stats thread) and one
 * consumer (the callback). Zephyr's ring buffer orders its index updates with acquire and
 * release barriers for that case (include/zephyr/sys/ring_buffer.h), so no lock is taken.
 *
 * SPDX-License-Identifier: Apache-2.0
 */

#include <zephyr/device.h>
#include <zephyr/devicetree.h>
#include <zephyr/drivers/uart.h>
#include <zephyr/kernel.h>
#include <zephyr/logging/log.h>
#include <zephyr/sys/atomic.h>
#include <zephyr/sys/ring_buffer.h>
#include <zephyr/sys/util.h>

#include "cdc_console.h"

LOG_MODULE_REGISTER(cdc_console, LOG_LEVEL_INF);

#define CMD_MAX 32U

static const struct device *const cdc_dev = DEVICE_DT_GET(DT_NODELABEL(cdc_acm_uart0));

RING_BUF_DECLARE(tx_ring, CONFIG_HID8K_CDC_RING_SIZE);

static atomic_t queued;
static atomic_t dropped;

static cdc_console_cmd_cb_t cmd_cb;
static char cmd_line[CMD_MAX + 1U];
static size_t cmd_len;
static bool cmd_overflow;

static void rx_byte(const uint8_t c)
{
	if (c == '\r' || c == '\n') {
		if (cmd_len > 0U && !cmd_overflow && cmd_cb != NULL) {
			cmd_line[cmd_len] = '\0';
			cmd_cb(cmd_line);
		}
		cmd_len = 0U;
		cmd_overflow = false;
		return;
	}

	if (cmd_len < CMD_MAX) {
		cmd_line[cmd_len++] = (char)c;
	} else {
		/* Not a command (echoed output, a modem probe): ignore the whole line. */
		cmd_overflow = true;
	}
}

static void rx_drain(const struct device *dev)
{
	uint8_t rx[16];
	int n;

	n = uart_fifo_read(dev, rx, sizeof(rx));
	for (int i = 0; i < n; i++) {
		rx_byte(rx[i]);
	}
}

/* Returns false when this run's byte budget is spent or the class took nothing. */
static bool tx_fill(const struct device *dev, const int space, uint32_t *const budget)
{
	uint8_t *data;
	uint32_t n;
	int sent;

	if (*budget == 0U) {
		/* Leave TX enabled: the class runs the callback again after the queue yields. */
		return false;
	}

	n = ring_buf_get_ptr(&tx_ring, &data, 0);
	n = MIN(n, MIN((uint32_t)space, *budget));
	if (n == 0U) {
		uart_irq_tx_disable(dev);
		return true;
	}

	sent = uart_fifo_fill(dev, data, (int)n);
	if (sent <= 0) {
		return false;
	}

	ring_buf_consume(&tx_ring, (size_t)sent);
	*budget -= MIN(*budget, (uint32_t)sent);

	return true;
}

static void cdc_irq_handler(const struct device *dev, void *user_data)
{
	uint32_t budget = CONFIG_HID8K_CDC_CHUNK;
	int space;

	ARG_UNUSED(user_data);

	while (true) {
		uart_irq_update(dev);
		if (uart_irq_is_pending(dev) <= 0) {
			break;
		}

		if (uart_irq_rx_ready(dev) > 0) {
			rx_drain(dev);
		}

		space = uart_irq_tx_ready(dev);
		if (space > 0 && !tx_fill(dev, space, &budget)) {
			break;
		}
	}
}

size_t cdc_console_write(const char *const data, const size_t len)
{
	uint32_t put;

	/*
	 * All or nothing: a line cut off by a full ring would run into the next one and spoil
	 * both for the host's line counter. This is the only producer, so the space can only
	 * grow between this check and the put.
	 */
	if (len == 0U || ring_buf_space_get(&tx_ring) < len) {
		(void)atomic_add(&dropped, (atomic_val_t)len);
		return 0U;
	}

	put = ring_buf_put(&tx_ring, (const uint8_t *)data, (uint32_t)len);

	(void)atomic_add(&queued, (atomic_val_t)put);
	if (put < len) {
		(void)atomic_add(&dropped, (atomic_val_t)(len - put));
	}

	if (put > 0U) {
		uart_irq_tx_enable(cdc_dev);
	}

	return put;
}

uint32_t cdc_console_queued(void)
{
	return (uint32_t)atomic_get(&queued);
}

uint32_t cdc_console_dropped(void)
{
	return (uint32_t)atomic_get(&dropped);
}

uint32_t cdc_console_pending(void)
{
	return ring_buf_size_get(&tx_ring);
}

int cdc_console_init(const cdc_console_cmd_cb_t cb)
{
	int ret;

	if (!device_is_ready(cdc_dev)) {
		LOG_ERR("CDC ACM device not ready");
		return -ENODEV;
	}

	cmd_cb = cb;

	ret = uart_irq_callback_user_data_set(cdc_dev, cdc_irq_handler, NULL);
	if (ret != 0) {
		LOG_ERR("uart_irq_callback_user_data_set failed: %d", ret);
		return ret;
	}

	uart_irq_rx_enable(cdc_dev);

	return 0;
}
```

## src/cdc_console.h
```c
/*
 * hid8k: the CDC ACM console (log lines out, one-word commands in).
 *
 * SPDX-License-Identifier: Apache-2.0
 */

#ifndef HID8K_CDC_CONSOLE_H_
#define HID8K_CDC_CONSOLE_H_

#include <stddef.h>
#include <stdint.h>

/* Called with each complete line received from the host, without its line ending. */
typedef void (*cdc_console_cmd_cb_t)(const char *line);

int cdc_console_init(cdc_console_cmd_cb_t cmd_cb);

/*
 * Queue bytes for the host, all or nothing: returns len, or 0 if the ring had no room for
 * all of them (then all are counted as dropped). Call from one thread only.
 */
size_t cdc_console_write(const char *data, size_t len);

/* Bytes queued and dropped since boot (both wrap at 2^32). */
uint32_t cdc_console_queued(void);
uint32_t cdc_console_dropped(void);

/* Bytes waiting in the ring for the host. */
uint32_t cdc_console_pending(void);

#endif /* HID8K_CDC_CONSOLE_H_ */
```

## src/hid8k.c
```c
/*
 * hid8k: one HID interface (NKRO keyboard, report ID 1, plus a vendor stats report, ID 2)
 * streamed at one report per high-speed microframe, paced from input_report_done.
 *
 * Threading. Everything that touches the report buffers and the counters below runs in the
 * USB device stack's thread ("usbd", cooperative, K_PRIO_COOP(8), usbd_core.c): the
 * iface_ready, input_report_done, get_report and idle callbacks (usbd_hid.c calls them from
 * usbd_hid_request() and the control handlers). The one exception is the refill kick
 * (kick_handler()), which runs on the system work queue: that thread is cooperative too
 * (BUILD_ASSERT below), and on this single core two cooperative threads never interleave
 * unless one blocks, which none of this code does. Other threads only read through
 * hid8k_take_snapshot(), which holds the scheduler lock while it copies, and set the atomics
 * at the top.
 *
 * SPDX-License-Identifier: Apache-2.0
 */

#include <errno.h>
#include <string.h>

#if !defined(CONFIG_HID8K_SIM)
#include <soc.h>
#endif
#include <zephyr/device.h>
#include <zephyr/devicetree.h>
#include <zephyr/input/input.h>
#include <zephyr/kernel.h>
#include <zephyr/logging/log.h>
#include <zephyr/sys/atomic.h>
#include <zephyr/sys/byteorder.h>
#include <zephyr/sys/util.h>
#include <zephyr/usb/class/usbd_hid.h>
#include <zephyr/usb/usbd.h>

#include "cdc_console.h"
#include "hid8k.h"
#include "hid8k_report.h"

LOG_MODULE_REGISTER(hid8k, LOG_LEVEL_INF);

#define DEPTH CONFIG_HID8K_QUEUE_DEPTH

/*
 * usbd_hid calls input_report_done() before it frees the completed transfer's net_buf
 * (usbd_hid_request(), usbd_hid.c), and hid_device_submit_report() takes a net_buf from the
 * same per-instance pool, so the pool needs one buffer more than the reports kept queued.
 */
BUILD_ASSERT(CONFIG_USBD_HID_IN_BUF_COUNT >= DEPTH + 1,
	     "CONFIG_USBD_HID_IN_BUF_COUNT must be at least CONFIG_HID8K_QUEUE_DEPTH + 1");

#define HID_NODE DT_INST(0, zephyr_hid_device)
BUILD_ASSERT(DT_PROP(HID_NODE, in_polling_period_us) == HID8K_NOMINAL_US,
	     "the HID node must set in-polling-period-us = <125> (bInterval 1 at high speed)");
BUILD_ASSERT(DT_PROP(HID_NODE, in_report_size) == HID8K_STATS_SIZE,
	     "in-report-size must be 64 so wMaxPacketSize is 64 (no alternate setting)");
BUILD_ASSERT(!IS_ENABLED(CONFIG_SMP), "the threading argument above assumes one core");
BUILD_ASSERT(CONFIG_SYSTEM_WORKQUEUE_PRIORITY < 0,
	     "the refill kick must run on a cooperative work queue, like the usbd thread");

#if defined(CONFIG_HID8K_SIM)
/* native_sim (sim/): Zephyr's cycle counter, k_cycle_get_32(), stands in for the DWT. */
#define CPU_HZ CONFIG_SYS_CLOCK_HW_CYCLES_PER_SEC
#else
/* The cycle counter runs at HCLK. */
#define RCC_NODE DT_NODELABEL(rcc)
#define CPU_HZ   (DT_PROP(RCC_NODE, clock_frequency) / DT_PROP(RCC_NODE, ahb_prescaler))
#endif

/* The button that sends the keyboard report: the board's sw0 (the Nucleo's blue USER button). */
#define BUTTON_CODE DT_PROP(DT_ALIAS(sw0), zephyr_code)

static const uint8_t report_desc[] = {
	/* Report ID 1: NKRO keyboard, a modifier byte and a bitmap of usages 0x00..0xDF. */
	HID_USAGE_PAGE(HID_USAGE_GEN_DESKTOP),
	HID_USAGE(HID_USAGE_GEN_DESKTOP_KEYBOARD),
	HID_COLLECTION(HID_COLLECTION_APPLICATION),
		HID_REPORT_ID(HID8K_REPORT_ID_KBD),
		HID_USAGE_PAGE(HID_USAGE_GEN_KEYBOARD),
		HID_USAGE_MIN8(0xE0),
		HID_USAGE_MAX8(0xE7),
		HID_LOGICAL_MIN8(0),
		HID_LOGICAL_MAX8(1),
		HID_REPORT_SIZE(1),
		HID_REPORT_COUNT(8),
		/* Input (Data, Var, Abs): the eight modifiers */
		HID_INPUT(0x02),
		HID_USAGE_MIN8(0x00),
		HID_USAGE_MAX8(HID8K_NKRO_BITS - 1U),
		HID_REPORT_COUNT(HID8K_NKRO_BITS),
		/* Input (Data, Var, Abs): one bit per key */
		HID_INPUT(0x02),
	HID_END_COLLECTION,

	/* Report ID 2: 63 vendor-defined bytes, the stats record (hid8k_report.h). */
	HID_USAGE_PAGE16(0xFF00),
	HID_USAGE(HID8K_VENDOR_USAGE),
	HID_COLLECTION(HID_COLLECTION_APPLICATION),
		HID_REPORT_ID(HID8K_REPORT_ID_STATS),
		HID_USAGE(HID8K_VENDOR_USAGE_DATA),
		HID_LOGICAL_MIN8(0),
		HID_LOGICAL_MAX16(0xFF, 0x00),
		HID_REPORT_SIZE(8),
		HID_REPORT_COUNT(HID8K_STATS_SIZE - 1U),
		/* Input (Data, Var, Abs) */
		HID_INPUT(0x02),
	HID_END_COLLECTION,
};

BUILD_ASSERT(HID8K_VENDOR_USAGE_PAGE == 0xFF00U, "report_desc spells the vendor page out");

/*
 * Report buffers. usbd_hid sends straight from them (net_buf_alloc_with_data(), zero copy),
 * so a buffer stays untouched from its submit until its input_report_done.
 */
static uint8_t __aligned(UDC_BUF_ALIGN) stats_buf[DEPTH][UDC_ROUND_UP(HID8K_STATS_SIZE)];
static uint8_t __aligned(UDC_BUF_ALIGN) kbd_buf[UDC_ROUND_UP(HID8K_KBD_SIZE)];

/* Set from other threads. */
static atomic_t button_down; /* input callback (system workqueue) */
static atomic_t cdc_heavy;   /* stats thread */

/* Owned by the usbd thread. */
static struct {
	const struct device *dev;
	struct usbd_context *uds_ctx;
	bool streaming;
	bool high_speed;
	unsigned int outstanding;      /* reports submitted and not yet completed */
	bool stats_queued[DEPTH];
	bool kbd_queued;
	/* Queued when the interface went down: they come back cancelled, not sent. */
	bool stats_stale[DEPTH];
	bool kbd_stale;
	uint32_t kbd_seq;              /* seq of the keyboard report in flight */
	bool kbd_sent_down;            /* F24 state in the last keyboard report submitted */
	uint32_t next_seq;
	bool have_prev_done;
	uint32_t prev_done_cyc;
	uint32_t last_done_seq;
	uint32_t last_done_cyc;
	uint16_t last_done_fn;
	uint32_t last_cost;
	int last_err;
	int last_stats_slot;
	/* Monotonic since boot, carried in every stats report. */
	uint32_t refused;
	uint32_t busy;
	uint32_t late;
	uint32_t kbd_count;
	uint32_t kicks;                /* refill kicks that found the queue empty */
	/* Since boot or the last reset. */
	uint32_t max_interval;
	uint32_t idle[3];              /* Set Idle durations per report ID, ms (stored only) */
} st;

static struct hid8k_stats win;
static struct hid8k_stats cum;

static uint32_t late_cycles;
static uint32_t bucket_cycles;

static inline uint32_t cycles_now(void)
{
#if defined(CONFIG_HID8K_SIM)
	return k_cycle_get_32();
#else
	return DWT->CYCCNT;
#endif
}

static inline uint16_t frame_number(void)
{
#if defined(CONFIG_HID8K_FRAME_NUMBER)
	/*
	 * Outside the USB stack: the stack does not expose the (micro)frame number, so this reads
	 * the OTG_HS core's device status register directly. Read-only, no side effects.
	 */
	const USB_OTG_DeviceTypeDef *const otg_dev =
		(const USB_OTG_DeviceTypeDef *)(DT_REG_ADDR(DT_NODELABEL(usbotg_hs)) +
						 USB_OTG_DEVICE_BASE);

	return (uint16_t)((otg_dev->DSTS & USB_OTG_DSTS_FNSOF_Msk) >> USB_OTG_DSTS_FNSOF_Pos);
#else
	return 0U;
#endif
}

static void stats_clear(struct hid8k_stats *s)
{
	memset(s, 0, sizeof(*s));
	s->interval_min = UINT32_MAX;
	s->cost_min = UINT32_MAX;
}

static void stats_add_interval(struct hid8k_stats *s, uint32_t d, uint32_t bucket)
{
	s->intervals++;
	s->interval_sum += d;
	s->interval_min = MIN(s->interval_min, d);
	s->interval_max = MAX(s->interval_max, d);
	s->hist[bucket]++;
	if (d > late_cycles) {
		s->late++;
	}
}

static void stats_add_cost(struct hid8k_stats *s, uint32_t cost)
{
	s->submits++;
	s->cost_sum += cost;
	s->cost_min = MIN(s->cost_min, cost);
	s->cost_max = MAX(s->cost_max, cost);
}

static uint8_t stats_flags(void)
{
	uint8_t flags = 0U;

	if (IS_ENABLED(CONFIG_HID8K_FRAME_NUMBER)) {
		flags |= HID8K_FLAG_FN_VALID;
	}
	if (atomic_get(&cdc_heavy) != 0) {
		flags |= HID8K_FLAG_CDC_HEAVY;
	}
	if (st.high_speed) {
		flags |= HID8K_FLAG_HIGH_SPEED;
	}

	return flags;
}

/* Fill a stats report; t_submit and fn_submit are written by the caller just before submit. */
static void stats_build(uint8_t *const b, const uint32_t seq)
{
	b[HID8K_OFF_ID] = HID8K_REPORT_ID_STATS;
	b[HID8K_OFF_FORMAT] = HID8K_FORMAT;
	b[HID8K_OFF_FLAGS] = stats_flags();
	b[HID8K_OFF_DEPTH] = DEPTH;
	sys_put_le32(seq, &b[HID8K_OFF_SEQ]);
	sys_put_le32(st.last_done_seq, &b[HID8K_OFF_DONE_SEQ]);
	sys_put_le32(st.last_done_cyc, &b[HID8K_OFF_T_DONE]);
	sys_put_le32(st.last_cost, &b[HID8K_OFF_SUBMIT_COST]);
	sys_put_le32(st.refused, &b[HID8K_OFF_REFUSED]);
	sys_put_le32(st.busy, &b[HID8K_OFF_BUSY]);
	sys_put_le32(st.late, &b[HID8K_OFF_LATE]);
	sys_put_le32(st.kbd_count, &b[HID8K_OFF_KBD_COUNT]);
	sys_put_le32(CPU_HZ, &b[HID8K_OFF_CPU_HZ]);
	sys_put_le16(st.last_done_fn, &b[HID8K_OFF_FN_DONE]);
	sys_put_le32(st.max_interval, &b[HID8K_OFF_MAX_INTERVAL]);
	sys_put_le32(k_uptime_get_32(), &b[HID8K_OFF_UPTIME_MS]);
	sys_put_le32(cdc_console_queued(), &b[HID8K_OFF_CDC_BYTES]);
	sys_put_le32(cdc_console_dropped(), &b[HID8K_OFF_CDC_DROPPED]);
}

static void kbd_build(uint8_t *const b, const bool down)
{
	memset(b, 0, HID8K_KBD_SIZE);
	b[0] = HID8K_REPORT_ID_KBD;
	/* b[1]: no modifiers. The bitmap starts at b[2] with usage 0x00. */
	if (down) {
		b[2U + HID8K_KEY_F24 / 8U] = (uint8_t)BIT(HID8K_KEY_F24 % 8U);
	}
}

/* Submit one report and account for it. Returns the submit call's result. */
static int submit(const uint8_t *const report, const uint16_t len, const uint32_t t0)
{
	int ret;
	uint32_t cost;

	ret = hid_device_submit_report(st.dev, len, report);
	cost = cycles_now() - t0;

	if (ret != 0) {
		st.refused++;
		st.last_err = ret;
		win.refused++;
		cum.refused++;
		return ret;
	}

	st.last_cost = cost;
	st.next_seq++;
	st.outstanding++;
	stats_add_cost(&win, cost);
	stats_add_cost(&cum, cost);

	return 0;
}

static int submit_kbd(const bool down)
{
	const uint32_t seq = st.next_seq;
	uint32_t t0;
	int ret;

	kbd_build(kbd_buf, down);
	st.kbd_queued = true;
	t0 = cycles_now();
	ret = submit(kbd_buf, HID8K_KBD_SIZE, t0);
	if (ret != 0) {
		st.kbd_queued = false;
		return ret;
	}

	st.kbd_seq = seq;
	st.kbd_sent_down = down;
	st.kbd_count++;
	win.kbd++;
	cum.kbd++;

	return 0;
}

static int submit_stats(void)
{
	uint8_t *b;
	uint32_t t0;
	int slot;
	int ret;

	for (slot = 0; slot < DEPTH; slot++) {
		if (!st.stats_queued[slot]) {
			break;
		}
	}

	if (slot == DEPTH) {
		st.busy++;
		win.busy++;
		cum.busy++;
		return -EBUSY;
	}

	b = stats_buf[slot];
	stats_build(b, st.next_seq);
	st.stats_queued[slot] = true;
	sys_put_le16(frame_number(), &b[HID8K_OFF_FN_SUBMIT]);
	t0 = cycles_now();
	sys_put_le32(t0, &b[HID8K_OFF_T_SUBMIT]);
	ret = submit(b, HID8K_STATS_SIZE, t0);
	if (ret != 0) {
		st.stats_queued[slot] = false;
		return ret;
	}

	st.last_stats_slot = slot;

	return 0;
}

/* Keep DEPTH reports queued. A keyboard report takes the place of a stats report. */
static void top_up(void)
{
	/*
	 * usbd_ep_enqueue() refuses every IN transfer with -EPERM while the stack has the bus
	 * marked suspended (subsys/usb/device_next/usbd_endpoint.c:145-149). A completion can
	 * be handled before the RESUME event that precedes it (usbd_core.c drains the transfer
	 * list first, usbd_event_handler()), so do not submit then, and count it as busy (the
	 * stats report has no spare field, and the run must not pass silently): the RESUME
	 * message kicks a refill (usb_device.c), and the stats thread kicks once per period as a
	 * backstop.
	 */
	if (st.uds_ctx != NULL && usbd_is_suspended(st.uds_ctx)) {
		if (st.streaming && st.outstanding < DEPTH) {
			st.busy++;
			win.busy++;
			cum.busy++;
		}
		return;
	}

	while (st.streaming && st.outstanding < DEPTH) {
		const bool down = atomic_get(&button_down) != 0;
		int ret;

		if (down != st.kbd_sent_down && !st.kbd_queued) {
			ret = submit_kbd(down);
		} else {
			ret = submit_stats();
		}

		if (ret != 0) {
			/* Try again at the next completion; never spin here. */
			break;
		}
	}
}

static void record_completion(const uint32_t now, const uint32_t seq)
{
	if (st.have_prev_done) {
		const uint32_t d = now - st.prev_done_cyc;
		const uint32_t bucket = MIN(d / bucket_cycles, HID8K_HIST_BUCKETS);

		stats_add_interval(&win, d, bucket);
		stats_add_interval(&cum, d, bucket);
		if (d > late_cycles) {
			st.late++;
		}
		st.max_interval = MAX(st.max_interval, d);
	}

	st.have_prev_done = true;
	st.prev_done_cyc = now;
	st.last_done_seq = seq;
	st.last_done_cyc = now;
	st.last_done_fn = frame_number();
	win.completions++;
	cum.completions++;
}

static void hid8k_input_report_done(const struct device *dev, const uint8_t *const report)
{
	const uint32_t now = cycles_now();
	bool stale;
	uint32_t seq;

	ARG_UNUSED(dev);

	if (report == kbd_buf) {
		seq = st.kbd_seq;
		stale = st.kbd_stale;
		st.kbd_queued = false;
		st.kbd_stale = false;
	} else {
		int slot;

		for (slot = 0; slot < DEPTH; slot++) {
			if (report == stats_buf[slot]) {
				break;
			}
		}

		if (slot == DEPTH) {
			return;
		}

		seq = sys_get_le32(&stats_buf[slot][HID8K_OFF_SEQ]);
		stale = st.stats_stale[slot];
		st.stats_queued[slot] = false;
		st.stats_stale[slot] = false;
	}

	if (st.outstanding > 0U) {
		st.outstanding--;
	}

	/*
	 * Disabling the interface dequeues its endpoint, and usbd_hid hands each cancelled
	 * transfer back through this callback (it does not pass the error on). Those are not
	 * completions: free the buffer and, if streaming again already, refill the queue.
	 */
	if (!stale && st.streaming) {
		record_completion(now, seq);
	}

	top_up();
}

static void hid8k_iface_ready(const struct device *dev, const bool ready)
{
	ARG_UNUSED(dev);

	if (ready) {
		st.high_speed = (st.uds_ctx != NULL) &&
				(usbd_bus_speed(st.uds_ctx) == USBD_SPEED_HS);
		st.have_prev_done = false;
		/* A new configuration starts with no key down on the host's side. */
		st.kbd_sent_down = false;
		st.streaming = true;
		/* Prime the queue; from here on input_report_done keeps it full. */
		top_up();
	} else {
		st.streaming = false;
		for (int slot = 0; slot < DEPTH; slot++) {
			st.stats_stale[slot] = st.stats_queued[slot];
		}
		st.kbd_stale = st.kbd_queued;
	}
}

static int hid8k_get_report_size(const struct device *dev, const uint8_t type, const uint8_t id)
{
	ARG_UNUSED(dev);

	if (type != HID_REPORT_TYPE_INPUT) {
		return 0;
	}

	switch (id) {
	case HID8K_REPORT_ID_KBD:
		return HID8K_KBD_SIZE;
	case HID8K_REPORT_ID_STATS:
		return HID8K_STATS_SIZE;
	default:
		return 0;
	}
}

static int hid8k_get_report(const struct device *dev, const uint8_t type, const uint8_t id,
			    const uint16_t len, uint8_t *const buf)
{
	uint8_t tmp[HID8K_STATS_SIZE];
	uint16_t n;

	ARG_UNUSED(dev);

	if (type != HID_REPORT_TYPE_INPUT) {
		return -ENOTSUP;
	}

	switch (id) {
	case HID8K_REPORT_ID_KBD:
		kbd_build(tmp, st.kbd_sent_down);
		n = HID8K_KBD_SIZE;
		break;
	case HID8K_REPORT_ID_STATS:
		if (st.last_stats_slot >= 0) {
			/* The most recently submitted stats report, as sent. */
			memcpy(tmp, stats_buf[st.last_stats_slot], HID8K_STATS_SIZE);
		} else {
			/*
			 * None sent yet (a host may ask while probing): answer with a valid
			 * report rather than a protocol stall. seq is the next one to be used.
			 */
			stats_build(tmp, st.next_seq);
			sys_put_le32(cycles_now(), &tmp[HID8K_OFF_T_SUBMIT]);
			sys_put_le16(frame_number(), &tmp[HID8K_OFF_FN_SUBMIT]);
		}
		n = HID8K_STATS_SIZE;
		break;
	default:
		return -ENOTSUP;
	}

	n = MIN(n, len);
	memcpy(buf, tmp, n);

	return n;
}

static void hid8k_set_idle(const struct device *dev, const uint8_t id, const uint32_t duration)
{
	ARG_UNUSED(dev);

	/* Stored for Get Idle only: the stream does not depend on the idle rate. */
	if (id < ARRAY_SIZE(st.idle)) {
		st.idle[id] = duration;
	}
}

static uint32_t hid8k_get_idle(const struct device *dev, const uint8_t id)
{
	ARG_UNUSED(dev);

	return (id < ARRAY_SIZE(st.idle)) ? st.idle[id] : 0U;
}

static const struct hid_device_ops hid8k_ops = {
	.iface_ready = hid8k_iface_ready,
	.get_report_size = hid8k_get_report_size,
	.get_report = hid8k_get_report,
	.set_idle = hid8k_set_idle,
	.get_idle = hid8k_get_idle,
	.input_report_done = hid8k_input_report_done,
};

static void hid8k_input_cb(struct input_event *evt, void *user_data)
{
	ARG_UNUSED(user_data);

	if (evt->type == INPUT_EV_KEY && evt->code == BUTTON_CODE) {
		atomic_set(&button_down, evt->value != 0 ? 1 : 0);
	}
}

INPUT_CALLBACK_DEFINE(NULL, hid8k_input_cb, NULL);

/*
 * The refill kick. Normally every completion refills the queue, so it never runs dry. If the
 * last outstanding report completes without a refill (top_up() skipped it because the bus
 * was still marked suspended, or the submit was refused), no completion is left to retry it
 * and the stream would stop for good. This work item restarts it. It acts only when nothing
 * is outstanding, so it cannot add to a queue the completions are already keeping full.
 */
static void kick_handler(struct k_work *work)
{
	ARG_UNUSED(work);

	if (st.streaming && st.outstanding == 0U &&
	    !(st.uds_ctx != NULL && usbd_is_suspended(st.uds_ctx))) {
		st.kicks++;
		top_up();
	}
}

static K_WORK_DEFINE(kick_work, kick_handler);

void hid8k_kick(void)
{
	(void)k_work_submit(&kick_work);
}

uint32_t hid8k_cpu_hz(void)
{
	return CPU_HZ;
}

void hid8k_cycle_counter_keepalive(void)
{
#if !defined(CONFIG_HID8K_SIM)
	DCB->DEMCR |= DCB_DEMCR_TRCENA_Msk;
	DWT->CTRL |= DWT_CTRL_CYCCNTENA_Msk;
#endif
}

void hid8k_set_cdc_heavy(const bool heavy)
{
	atomic_set(&cdc_heavy, heavy ? 1 : 0);
}

void hid8k_take_snapshot(struct hid8k_snapshot *const snap, const bool reset_cum)
{
	k_sched_lock();

	snap->cycles = cycles_now();
	snap->uptime_ms = k_uptime_get();
	snap->win = win;
	snap->cum = cum;
	snap->next_seq = st.next_seq;
	snap->outstanding = st.outstanding;
	snap->kicks = st.kicks;
	snap->last_err = st.last_err;
	snap->streaming = st.streaming;
	snap->high_speed = st.high_speed;

	stats_clear(&win);
	if (reset_cum) {
		stats_clear(&cum);
		st.max_interval = 0U;
	}

	k_sched_unlock();
}

int hid8k_init(struct usbd_context *const uds_ctx)
{
	int ret;

#if !defined(CONFIG_HID8K_SIM)
	/* The DWT cycle counter: the timestamps in every stats report. */
	DCB->DEMCR |= DCB_DEMCR_TRCENA_Msk;
	if ((DWT->CTRL & DWT_CTRL_NOCYCCNT_Msk) != 0U) {
		LOG_ERR("DWT has no cycle counter: no timestamps");
		return -ENOTSUP;
	}
	DWT->CYCCNT = 0U;
	DWT->CTRL |= DWT_CTRL_CYCCNTENA_Msk;
#endif

	late_cycles = (uint32_t)(((uint64_t)CPU_HZ * HID8K_LATE_US_X10) / 10000000U);
	bucket_cycles = (uint32_t)(((uint64_t)CPU_HZ * HID8K_HIST_BUCKET_US_X10) / 10000000U);

	stats_clear(&win);
	stats_clear(&cum);
	st.uds_ctx = uds_ctx;
	st.last_stats_slot = -1;

	st.dev = DEVICE_DT_GET(HID_NODE);
	if (!device_is_ready(st.dev)) {
		LOG_ERR("HID device not ready");
		return -ENODEV;
	}

	ret = hid_device_register(st.dev, report_desc, sizeof(report_desc), &hid8k_ops);
	if (ret != 0) {
		LOG_ERR("hid_device_register failed: %d", ret);
	}

	return ret;
}
```

## src/hid8k.h
```c
/*
 * hid8k: the paced HID stream and its firmware-side statistics.
 *
 * SPDX-License-Identifier: Apache-2.0
 */

#ifndef HID8K_H_
#define HID8K_H_

#include <stdbool.h>
#include <stdint.h>

#include <zephyr/usb/usbd.h>

/* Completion-interval histogram: 12.5 us buckets from 0 to 500 us, then one overflow bucket. */
#define HID8K_HIST_BUCKET_US_X10 125U
#define HID8K_HIST_BUCKETS       40U
#define HID8K_HIST_SLOTS         (HID8K_HIST_BUCKETS + 1U)

/* Statistics over one window (between two snapshots) or since boot / the last reset. */
struct hid8k_stats {
	uint32_t completions;  /* input_report_done callbacks while streaming */
	uint32_t intervals;    /* completion-to-completion intervals measured */
	uint64_t interval_sum; /* cycles */
	uint32_t interval_min; /* cycles */
	uint32_t interval_max; /* cycles */
	uint32_t late;         /* intervals > 1.5 x 125 us */
	uint32_t hist[HID8K_HIST_SLOTS];
	uint32_t submits;      /* successful hid_device_submit_report calls */
	uint64_t cost_sum;     /* cycles spent in those calls */
	uint32_t cost_min;
	uint32_t cost_max;
	uint32_t refused;      /* calls that returned an error */
	uint32_t busy;         /* wanted to submit but could not: no free buffer, or suspended */
	uint32_t kbd;          /* keyboard reports submitted */
};

/* What the stats thread gets each time it looks. */
struct hid8k_snapshot {
	struct hid8k_stats win; /* since the previous snapshot */
	struct hid8k_stats cum; /* since boot or the last reset */
	uint32_t cycles;        /* DWT CYCCNT when the snapshot was taken */
	int64_t uptime_ms;      /* k_uptime_get() at the same moment, to cross-check CYCCNT */
	uint32_t next_seq;
	uint32_t outstanding;   /* reports submitted and not yet completed */
	uint32_t kicks;         /* times the refill kick found the queue empty, since boot */
	int last_err;           /* last non-zero hid_device_submit_report return */
	bool streaming;         /* the HID interface is in the active configuration */
	bool high_speed;
};

/* Cycle counter frequency (the CPU clock). */
uint32_t hid8k_cpu_hz(void);

/* Start the cycle counter and register the HID device. Call before usbd_init(). */
int hid8k_init(struct usbd_context *uds_ctx);

/*
 * Set the trace and cycle-counter enable bits again (idempotent). A debug probe that
 * connects or detaches can rewrite DEMCR; the stats thread calls this once per period.
 */
void hid8k_cycle_counter_keepalive(void);

/*
 * Ask for a refill of the IN queue from the system work queue: it acts only while
 * streaming, not suspended, and with nothing outstanding (a submit was refused and no
 * completion is left to retry it). Safe to call from any thread.
 */
void hid8k_kick(void);

/* Copy and clear the window; optionally clear the cumulative statistics too. */
void hid8k_take_snapshot(struct hid8k_snapshot *snap, bool reset_cum);

/* Flag carried in each stats report: heavy CDC traffic mode is on. */
void hid8k_set_cdc_heavy(bool heavy);

#endif /* HID8K_H_ */
```

## src/usb_device.h
```c
/*
 * hid8k: the USB device.
 *
 * SPDX-License-Identifier: Apache-2.0
 */

#ifndef HID8K_USB_DEVICE_H_
#define HID8K_USB_DEVICE_H_

#include <zephyr/usb/usbd.h>

enum hid8k_usb_state {
	HID8K_USB_DEFAULT = 0,
	HID8K_USB_ADDRESSED,
	HID8K_USB_CONFIGURED,
	HID8K_USB_SUSPENDED,
};

/* The device context, available before hid8k_usb_init() (it is statically defined). */
struct usbd_context *hid8k_usbd_context(void);

/* Add descriptors and configurations, register the classes, and initialize the stack. */
int hid8k_usb_init(void);

/* Connect to the bus (or wait for VBUS, if the controller reports it). */
int hid8k_usb_enable(void);

enum hid8k_usb_state hid8k_usb_state(void);

#endif /* HID8K_USB_DEVICE_H_ */
```

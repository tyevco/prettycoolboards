/* Deep sleep: every pad goes to its SLEEP state from the pin plan (components/board/pin_plan_table.c,
 * generated by tools/pin_plan.py), ext1 wake on the plan's wake pins: IMU_INT1 (pickup), the three
 * buttons and CHG_INT_N (USB plugged). */
#include "board_pins.h"
#include "compass.h"
#include "driver/gpio.h"
#include "driver/ledc.h"
#include "esp_log.h"
#include "esp_sleep.h"
#include "freertos/FreeRTOS.h"
#include "freertos/task.h"
#include "imu.h"
#include "pin_plan.h"
#include "power.h"

static const char *TAG = "sleep";

#define BTN_MASK ((1ULL << PIN_BTN_ZERO_N) | (1ULL << PIN_BTN_HOLD_N) | (1ULL << PIN_BTN_MODE_N))

void power_release_holds(void)
{
    pin_plan_release_holds(); /* every pad the SLEEP plan holds */
}

static bool any_button_down(void)
{
    return !gpio_get_level(PIN_BTN_ZERO_N) || !gpio_get_level(PIN_BTN_HOLD_N) || !gpio_get_level(PIN_BTN_MODE_N);
}

void power_deep_sleep(void)
{
    power_backlight(0);
    power_led(0, 0, 0);
    ledc_stop(LEDC_LOW_SPEED_MODE, LEDC_CHANNEL_0, 0);
    ledc_stop(LEDC_LOW_SPEED_MODE, LEDC_CHANNEL_1, 0);

    /* a button still held would wake us at once */
    for (int i = 0; i < 300 && any_button_down(); i++) {
        vTaskDelay(pdMS_TO_TICKS(10));
    }

    /* the wake pins come from the plan; every one has an external pull-up (buttons 100 k,
     * CHG_INT_N 10 k) or a push-pull driver (IMU INT1), so the plan turns every pull off (pad and
     * RTC) and RTC_PERIPH can power down */
    uint64_t mask = pin_plan_wake_mask();
    /* gyroscope off, accelerometer to ultra-low-power 12.5 Hz, wake-up latch cleared (imu.c) */
    if (!power_imu_sleep_prepare()) {
        mask &= ~(1ULL << PIN_IMU_INT1); /* LSM6DSO INT1 is active low, latched: low now = no pickup wake */
    }
    power_compass_sleep_prepare(); /* the sampler that polls it has stopped: power-down (compass.c) */
    /* Every pad to its SLEEP state: wake inputs, the gates (backlight, piezo: GPIO45 strap stays low),
     * the rail switch and every line into the switched rails driven low with NO pull, the rest
     * isolated; then held. (Before: the LCD / RGB lines went through gpio_reset_pin(), which turns
     * the pull-up on, and were held low against it: ~73 uA x 6.) */
    pin_plan_apply(PP_MODE_SLEEP, ~0ULL, PP_APPLY_LEVEL | PP_APPLY_HOLD);
    esp_sleep_enable_ext1_wakeup(mask, ESP_EXT1_WAKEUP_ANY_LOW);

    ESP_LOGI(TAG, "deep sleep, wake mask 0x%llx", (unsigned long long)mask);
    vTaskDelay(pdMS_TO_TICKS(20)); /* let the log drain */
    esp_deep_sleep_start();
}

void power_ui_lines_low(void)
{
    /* +3V3_UI (ST7789 VDD, WS2812) goes off with SNS_PWR_EN: don't back-power them through the
     * ESD diodes of their inputs (SPEC §3). Takes the pins from SPI / RMT: the plan's SLEEP state
     * (low, pulls off), not held yet. RGB_DIN's circuit is R55 to GND, so it is in the UI set by
     * its load, not its pull: add it explicitly. */
    pin_plan_apply(PP_MODE_SLEEP, pin_plan_rail_mask(PP_RAIL_UI) | (1ULL << PIN_RGB_DIN), PP_APPLY_LEVEL);
}

const char *power_wake_cause(void)
{
    switch (esp_sleep_get_wakeup_cause()) {
    case ESP_SLEEP_WAKEUP_EXT1: {
        uint64_t m = esp_sleep_get_ext1_wakeup_status();
        if (m & (1ULL << PIN_IMU_INT1)) return "pickup";
        if (m & (1ULL << PIN_CHG_INT_N)) return "usb";
        if (m & BTN_MASK) return "button";
        return "ext1";
    }
    case ESP_SLEEP_WAKEUP_UNDEFINED:
        return "power-on";
    default:
        return "other";
    }
}

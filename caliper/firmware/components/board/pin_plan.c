/* Pin plan helpers (portable C; the table itself is pin_plan_table.c, generated by tools/pin_plan.py). */
#include "pin_plan.h"

const pin_plan_t *pin_plan_find(int gpio)
{
    for (size_t i = 0; i < PIN_PLAN_COUNT; i++) {
        if (PIN_PLAN[i].gpio == gpio) {
            return &PIN_PLAN[i];
        }
    }
    return NULL;
}

bool pin_plan_is_rtc_gpio(int gpio)
{
    return gpio >= 0 && gpio <= 21; /* ESP32-S3 DS v2.2 Table 2-1: RTC IO MUX on GPIO0-GPIO21 */
}

bool pin_plan_rail_on(uint8_t rail, pp_mode_t mode)
{
    switch (rail) {
    case PP_RAIL_3V3:
        return mode == PP_MODE_RESET || mode == PP_MODE_RUN || mode == PP_MODE_SLEEP;
    case PP_RAIL_SNS:
    case PP_RAIL_UI:
        return mode == PP_MODE_RUN; /* SNS_PWR_EN: low at reset (R5), high awake, low asleep */
    default:
        return false;
    }
}

uint64_t pin_plan_init_mask(pp_init_t init)
{
    uint64_t m = 0;
    for (size_t i = 0; i < PIN_PLAN_COUNT; i++) {
        if (PIN_PLAN[i].init == init && !PIN_PLAN[i].untouched) {
            m |= 1ULL << PIN_PLAN[i].gpio;
        }
    }
    return m;
}

uint64_t pin_plan_wake_mask(void)
{
    uint64_t m = 0;
    for (size_t i = 0; i < PIN_PLAN_COUNT; i++) {
        if (PIN_PLAN[i].st[PP_MODE_SLEEP].wake) {
            m |= 1ULL << PIN_PLAN[i].gpio;
        }
    }
    return m;
}

uint64_t pin_plan_rail_mask(pp_rail_t rail)
{
    uint64_t m = 0;
    for (size_t i = 0; i < PIN_PLAN_COUNT; i++) {
        if (PIN_PLAN[i].ext.rail == rail) {
            m |= 1ULL << PIN_PLAN[i].gpio;
        }
    }
    return m;
}

const char *pin_plan_mode_name(pp_mode_t mode)
{
    static const char *const names[PP_MODE_COUNT] = {"RESET", "RUN", "SLEEP", "SHIP"};
    return (unsigned)mode < PP_MODE_COUNT ? names[mode] : "?";
}

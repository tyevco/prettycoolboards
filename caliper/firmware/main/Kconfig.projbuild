## caliper/firmware/main/Kconfig.projbuild
```kconfig
menu "PrettyCool Caliper"

    config CALIPER_LOG_CAPACITY
        int "Reading-log capacity (records of 16 bytes)"
        range 256 65536
        default 4096
        help
            Size of the LittleFS ring log, kept in 4 KiB segment files of 256 records
            (4096 records = 16 files, 64 KiB). The CSV export of a full log is about
            130-160 KiB and must fit the "msc" FAT partition.

    config CALIPER_MAG_DIR_INVERT
        bool "Invert the AS5311 counting direction"
        default n
        help
            Flip if the reading decreases when the jaws open (depends on the tape orientation).

    config CALIPER_CAP_SENSOR
        bool "Enable the EXPERIMENTAL capacitive scale"
        default y
        help
            Drives CAP_TX0..7 and samples CAP_RX. Isolated from the magnetic path: if it fails
            to start, LIVE.cap_nm reads INT32_MIN and nothing else changes.

    config CALIPER_UI_AUTO_FLIP
        bool "Turn the display 180 degrees when the caliper is held top edge down"
        default y
        help
            Uses the LSM6DSO orientation (components/measure/orient.c): the picture turns when the
            top (button) edge points at least about 20 degrees below the horizon for 0.6 s, and
            back when it points up again. Lying flat keeps the current state. With this off, or
            without an IMU, the display stays as mounted.

    config CALIPER_USB_TINYUSB
        bool "Use TinyUSB (CDC console + MSC) instead of USB-Serial-JTAG"
        default y
        help
            With TinyUSB the native USB PHY belongs to TinyUSB, so esptool's automatic reset
            into the bootloader over USB-Serial-JTAG stops working: use the CLI command
            "bootloader" or hold BOOT while resetting. Disable for firmware development.

    config CALIPER_USB_MSC
        bool "Expose LOG.CSV as a USB mass-storage drive"
        depends on CALIPER_USB_TINYUSB
        default y

    config CALIPER_CHG_TS_ENABLE
        bool "BQ25180 TS (thermistor) monitoring"
        default y
        help
            Rev A has a 10 k NTC (RT1) on TS/MR next to the battery connector (docs/electronics.md).
            Disable only on a board without it (TS then needs a plain 10 k to GND). The firmware
            also guards charging with the ESP32-S3 die temperature in both cases.

    config CALIPER_BRINGUP
        bool "Bring-up checks on the USB console (the \"bu\" commands)"
        default y
        help
            The guided first-board checks of docs/bringup.md (rails, I2C, charger, gauge, IMU,
            sensor rail, AS5311, display, buttons, piezo, LED, capacitive front-end, BLE and
            Wi-Fi RSSI, sleep, ship mode) as CLI commands in the normal image. About 24 KB of
            flash; with it off the linker drops the commands and the scan / test-pattern helpers
            they alone use.

    config CALIPER_CHARGE_MA
        int "Charge current (mA)"
        range 10 135
        default 70
        help
            BQ25180 fast-charge current (ICHG). The cell is a Renata ICP501230PS-03 (135 mAh typ,
            130 min): 0.5C (67 mA) standard and 1C (135 mA) maximum charge, so the range stops at
            1C. 70 mA is the BQ25180 step nearest 0.5C (0.52C typ, 0.54C on a 130 mAh cell; +10 %
            ICHG tolerance: 77 mA = 0.59C). Steps are 1 mA up to 35 mA and 10 mA from 40 mA
            (SLUSE99C ICHG_CTRL); other values round down. Termination (10 %) and precharge
            (2 x termination) follow it.

    config CALIPER_WIFI_MIN_MV
        int "Lowest cell voltage for Wi-Fi without USB (mV)"
        range 3300 3800
        default 3500
        help
            Without VBUS, Wi-Fi does not start while the MAX17048 reads VCELL below this value and
            is switched off once VCELL drops 100 mV below it. The 135 mAh cell is rated for 2C
            (270 mA) pulses; even with the TX power capped (CONFIG_ESP_PHY_MAX_WIFI_TX_POWER) a
            Wi-Fi burst pulls about 0.27 A from it, and its resistance (about 1 ohm with the PCM
            and Q1, estimate) sags VBAT by about 0.2 V. 3.5 V keeps that sag above the BQ25180
            battery UVLO (3.0 V, 60 us deglitch) with margin. BLE stays on.

endmenu
```

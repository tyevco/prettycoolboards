/*
 * Invariants of the pin plan (components/board/pin_plan_table.c, generated by tools/pin_plan.py).
 * The firmware applies this table at sleep entry and boot, so a state that passes here is the state
 * the pads get. Each rule below is one way a pad leaks or a strap goes wrong.
 */
#include <stdio.h>
#include <string.h>

#include "board_pins.h"
#include "pin_plan.h"
#include "tiny_test.h"

int tt_failures = 0;
int tt_checks = 0;
const char *tt_current = "";

static const char *const MODE[PP_MODE_COUNT] = {"RESET", "RUN", "SLEEP", "SHIP"};

/* Level a reset pad settles to: the board's pull wins over the 45 k internal pull. -1 = floating. */
static int reset_level(const pin_plan_t *p)
{
    const pp_state_t *s = &p->st[PP_MODE_RESET];
    if (p->ext.kind == PP_EXT_PULL_UP && pin_plan_rail_on(p->ext.rail, PP_MODE_RESET)) return 1;
    if (p->ext.kind == PP_EXT_PULL_DOWN) return 0;
    if (s->pull == PP_PULL_UP) return 1;
    if (s->pull == PP_PULL_DOWN) return 0;
    return -1;
}

static bool drives(const pp_state_t *s, int *level)
{
    if ((s->dir == PP_DIR_OUT || s->dir == PP_DIR_PERIPH) && s->level != PP_LEVEL_NONE) {
        *level = s->level;
        return true;
    }
    if (s->dir == PP_DIR_OD && s->level == 0) {
        *level = 0;
        return true;
    }
    return false;
}

/* Number of rules a state breaks (printing each). Used on the real table and on a mutated entry. */
static int violations(const pin_plan_t *p, pp_mode_t m, const pp_state_t *s, bool quiet)
{
    int bad = 0;
#define RULE(cond, ...)                                                                            \
    do {                                                                                           \
        if (cond) {                                                                                \
            bad++;                                                                                 \
            if (!quiet) {                                                                          \
                printf("    GPIO%d %s %s: ", p->gpio, p->net, MODE[m]);                            \
                printf(__VA_ARGS__);                                                               \
                printf("\n");                                                                      \
            }                                                                                      \
        }                                                                                          \
    } while (0)
    int lvl = 0;
    bool drv = drives(s, &lvl);
    bool ext_on = pin_plan_rail_on(p->ext.rail, m);

    /* 1. a driven pad never fights its own internal pull (bug 1: gpio_reset_pin + low + hold) */
    RULE(drv && lvl == 0 && s->pull == PP_PULL_UP, "driven low against its internal pull-up");
    RULE(drv && lvl == 1 && s->pull == PP_PULL_DOWN, "driven high against its internal pull-down");

    /* 2. an internal pull never opposes the board's pull on a powered rail (a divider) */
    RULE(s->pull == PP_PULL_UP && p->ext.kind == PP_EXT_PULL_DOWN, "internal pull-up against an external pull-down");
    RULE(s->pull == PP_PULL_DOWN && p->ext.kind == PP_EXT_PULL_UP && ext_on,
         "internal pull-down against an external pull-up");

    /* 3. holds are a deep-sleep thing only */
    RULE(s->hold && m != PP_MODE_SLEEP, "hold outside SLEEP");
    RULE(s->wake && m != PP_MODE_SLEEP, "wake outside SLEEP");

    /* 4. nothing is unpowered but SHIP, and SHIP is all unpowered */
    RULE((m == PP_MODE_SHIP) != (s->dir == PP_DIR_OFF), "dir OFF exactly in SHIP");

    /* 5. in an output-capable mode a level is given for every push-pull / open-drain pad */
    RULE((s->dir == PP_DIR_OUT || s->dir == PP_DIR_OD) && s->level == PP_LEVEL_NONE, "output with no level");

    if (m == PP_MODE_SLEEP) {
        /* 6. a held output does not drive against the board's pull (the 35 uA budget) */
        RULE(drv && lvl == 1 && p->ext.kind == PP_EXT_PULL_DOWN, "held high against an external pull-down");
        RULE(drv && lvl == 0 && p->ext.kind == PP_EXT_PULL_UP && ext_on, "held low against an external pull-up");
        /* 7. no back-powering of a switched-off rail: no pull-up / high level into its chips */
        RULE(!ext_on && p->ext.rail != PP_RAIL_NONE && (s->pull == PP_PULL_UP || (drv && lvl == 1)),
             "pull-up or high level into a chip on a rail that is off in SLEEP");
        /* 8. no floating input: an enabled input has a level from the board or a pull */
        RULE(s->dir == PP_DIR_IN && s->pull == PP_PULL_NONE &&
                 !((p->ext.kind == PP_EXT_PULL_UP || p->ext.kind == PP_EXT_DRIVEN) && ext_on) &&
                 p->ext.kind != PP_EXT_PULL_DOWN,
             "input with nothing setting its level");
        /* 9. an RTC pad keeps its pulls in deep sleep and ESP-IDF isolates only digital pads, so every
         *    RTC pad the plan owns is held (or is a wake input); every output is held */
        RULE(!p->untouched && pin_plan_is_rtc_gpio(p->gpio) && !s->hold && !s->wake, "RTC pad neither held nor a wake input");
        RULE((s->dir == PP_DIR_OUT || s->dir == PP_DIR_OD) && !s->hold, "output not held");
        /* 10. wake pins: RTC GPIOs, inputs, no pull (each has a board pull-up or a driver), not held */
        RULE(s->wake && !pin_plan_is_rtc_gpio(p->gpio), "wake pin not an RTC GPIO (0-21)");
        RULE(s->wake && s->dir != PP_DIR_IN, "wake pin not an input");
        RULE(s->wake && s->pull != PP_PULL_NONE, "wake pin with an internal pull");
        RULE(s->wake && s->hold, "wake pin held");
    }
    return bad;
#undef RULE
}

static void test_every_board_pin_once(void)
{
    tt_current = "every board_pins.h GPIO in the plan exactly once";
    const int all[] = BOARD_PINS_ALL;
    CHECK_EQ_INT(sizeof(all) / sizeof(all[0]), BOARD_PINS_COUNT);
    CHECK_EQ_INT(PIN_PLAN_COUNT, BOARD_PINS_COUNT);
    for (size_t i = 0; i < sizeof(all) / sizeof(all[0]); i++) {
        int n = 0;
        for (size_t k = 0; k < PIN_PLAN_COUNT; k++) {
            n += PIN_PLAN[k].gpio == all[i];
        }
        if (n != 1) printf("    GPIO%d is in the plan %d times\n", all[i], n);
        CHECK_EQ_INT(n, 1);
        CHECK(pin_plan_find(all[i]) != NULL);
    }
    for (size_t k = 0; k < PIN_PLAN_COUNT; k++) {
        int g = PIN_PLAN[k].gpio;
        CHECK(g != 26);                                 /* in-package PSRAM CS on N4R2 */
        CHECK((g >= 0 && g <= 21) || (g >= 33 && g <= 48)); /* bonded GPIOs of the MINI-1 */
        CHECK(PIN_PLAN[k].net && PIN_PLAN[k].net[0]);
    }
}

static void test_rules_hold_for_every_state(void)
{
    tt_current = "pin-plan rules";
    for (size_t k = 0; k < PIN_PLAN_COUNT; k++) {
        for (int m = 0; m < PP_MODE_COUNT; m++) {
            CHECK_EQ_INT(violations(&PIN_PLAN[k], (pp_mode_t)m, &PIN_PLAN[k].st[m], false), 0);
        }
    }
}

static void test_straps(void)
{
    tt_current = "strap levels at reset";
    const pin_plan_t *g0 = pin_plan_find(0), *g45 = pin_plan_find(45), *g46 = pin_plan_find(46), *g3 = pin_plan_find(3);
    CHECK(g0 && g45 && g46 && g3);
    if (!(g0 && g45 && g46 && g3)) return;
    CHECK_EQ_INT(reset_level(g0), 1);  /* GPIO0 = 1: SPI boot (DS v2.2 Table 3-3) */
    CHECK_EQ_INT(reset_level(g45), 0); /* GPIO45 = 0: VDD_SPI 3.3 V (Table 3-4); a 1 selects 1.8 V */
    CHECK(reset_level(g46) != 1);      /* GPIO46 = 0 or floating */
    CHECK(g3->st[PP_MODE_RESET].pull == PP_PULL_NONE); /* GPIO3 has no internal pull (Table 3-1): any */
    /* the internal reset pulls are the datasheet's (Table 2-1) */
    CHECK_EQ_INT(g0->st[PP_MODE_RESET].pull, PP_PULL_UP);
    CHECK_EQ_INT(g45->st[PP_MODE_RESET].pull, PP_PULL_DOWN);
    CHECK_EQ_INT(g46->st[PP_MODE_RESET].pull, PP_PULL_DOWN);
    /* and the straps' gates stay off through sleep */
    CHECK_EQ_INT(g45->st[PP_MODE_SLEEP].level, 0);
    CHECK_EQ_INT(g46->st[PP_MODE_SLEEP].level, 0);
}

static void test_wake_mask(void)
{
    tt_current = "ext1 wake mask";
    uint64_t want = (1ULL << PIN_BTN_ZERO_N) | (1ULL << PIN_BTN_HOLD_N) | (1ULL << PIN_BTN_MODE_N) |
                    (1ULL << PIN_CHG_INT_N) | (1ULL << PIN_IMU_INT1);
    CHECK(pin_plan_wake_mask() == want);
    CHECK((pin_plan_wake_mask() & ~0x3FFFFFULL) == 0); /* RTC GPIOs only */
}

static void test_masks(void)
{
    tt_current = "init / rail masks";
    uint64_t all = 0;
    for (size_t k = 0; k < PIN_PLAN_COUNT; k++) all |= 1ULL << PIN_PLAN[k].gpio;
    uint64_t u = pin_plan_init_mask(PP_INIT_BOARD) | pin_plan_init_mask(PP_INIT_SENSOR_MAG) |
                 pin_plan_init_mask(PP_INIT_BUTTONS) | pin_plan_init_mask(PP_INIT_DRIVER);
    uint64_t usb = (1ULL << PIN_USB_DM) | (1ULL << PIN_USB_DP);
    CHECK(u == (all & ~usb)); /* every pad but the USB pair has an owner that applies its RUN state */
    CHECK((pin_plan_init_mask(PP_INIT_BOARD) & pin_plan_init_mask(PP_INIT_DRIVER)) == 0);
    /* every LCD line is in the +3V3_UI set that power_ui_lines_low() drives low */
    uint64_t lcd = (1ULL << PIN_LCD_SCK) | (1ULL << PIN_LCD_MOSI) | (1ULL << PIN_LCD_CS_N) | (1ULL << PIN_LCD_DC) |
                   (1ULL << PIN_LCD_RST_N);
    CHECK((pin_plan_rail_mask(PP_RAIL_UI) & lcd) == lcd);
    for (size_t k = 0; k < PIN_PLAN_COUNT; k++) {
        const pin_plan_t *p = &PIN_PLAN[k];
        CHECK(p->untouched == ((usb >> p->gpio) & 1)); /* only the USB pair is left to the PHY */
        /* a pin a driver owns is PERIPH in RUN, every other one is a plain GPIO state */
        CHECK((p->init == PP_INIT_DRIVER) == (p->st[PP_MODE_RUN].dir == PP_DIR_PERIPH));
    }
}

/* The checker itself: the two pre-fix configurations must be caught. */
static void test_rules_catch_the_old_bugs(void)
{
    tt_current = "rules catch bug 1 (gpio_reset_pin before a held low)";
    const pin_plan_t *sck = pin_plan_find(PIN_LCD_SCK), *rgb = pin_plan_find(PIN_RGB_DIN);
    CHECK(sck && rgb);
    if (!sck || !rgb) return;
    pp_state_t old = {PP_DIR_OUT, 0, PP_PULL_UP, true, false}; /* gpio_reset_pin -> output 0 -> hold */
    CHECK(violations(sck, PP_MODE_SLEEP, &old, true) >= 1);
    CHECK(violations(rgb, PP_MODE_SLEEP, &old, true) >= 2); /* + pull-up against R55's pull-down */
    pp_state_t fixed = {PP_DIR_OUT, 0, PP_PULL_NONE, true, false};
    CHECK_EQ_INT(violations(sck, PP_MODE_SLEEP, &fixed, true), 0);

    tt_current = "rules catch a PCNT pull-up surviving into sleep";
    const pin_plan_t *a = pin_plan_find(PIN_MAG_A);
    CHECK(a != NULL);
    if (!a) return;
    pp_state_t pcnt = {PP_DIR_IN, PP_LEVEL_NONE, PP_PULL_UP, false, false};
    CHECK(violations(a, PP_MODE_SLEEP, &pcnt, true) >= 1); /* back-powers the AS5311 on the off rail */

    tt_current = "rules catch a wake pin with an RTC pull-down";
    const pin_plan_t *b = pin_plan_find(PIN_BTN_ZERO_N);
    CHECK(b != NULL);
    if (!b) return;
    pp_state_t pd = {PP_DIR_IN, PP_LEVEL_NONE, PP_PULL_DOWN, false, true};
    CHECK(violations(b, PP_MODE_SLEEP, &pd, true) >= 2);
}

int main(void)
{
    test_every_board_pin_once();
    test_rules_hold_for_every_state();
    test_straps();
    test_wake_mask();
    test_masks();
    test_rules_catch_the_old_bugs();
    printf("pin_plan_tests: %d checks, %d failures (plan %s, %d pins)\n", tt_checks, tt_failures, PIN_PLAN_HASH,
           (int)PIN_PLAN_COUNT);
    return tt_failures ? 1 : 0;
}
